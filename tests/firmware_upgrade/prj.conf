## CMakeLists.txt
```
#
# Copyright (c) 2022 Nofence AS
#

cmake_minimum_required(VERSION 3.20.0)

find_package(Zephyr REQUIRED HINTS $ENV{ZEPHYR_BASE})
project(firmware_upgrade_testing)

zephyr_include_directories(${CMAKE_CURRENT_BINARY_DIR})
include_directories(${CMAKE_CURRENT_BINARY_DIR})

FILE(GLOB app_sources
  ${CMAKE_CURRENT_SOURCE_DIR}/src/*.c
  ${CMAKE_CURRENT_SOURCE_DIR}/mock/*.c
  ${CMAKE_CURRENT_SOURCE_DIR}/mock/net/*.c
  ${CMAKE_CURRENT_SOURCE_DIR}/mock/power/*.c
  ${CMAKE_CURRENT_SOURCE_DIR}/../../src/events/fw_upgrade/*.c
  ${CMAKE_CURRENT_SOURCE_DIR}/../../src/events/error_handler/*.c
  ${CMAKE_CURRENT_SOURCE_DIR}/../../src/events/power_manager/*.c
  ${CMAKE_CURRENT_SOURCE_DIR}/../../src/modules/fw_upgrade/*.c
  ${CMAKE_CURRENT_SOURCE_DIR}/../../src/events/diagnostics/diagnostics_events.c
  ${CMAKE_CURRENT_SOURCE_DIR}/../../src/modules/diagnostics/diagnostic_flags.c      
)
target_sources(app PRIVATE ${app_sources})
target_include_directories(app PRIVATE ${APP_SOURCE})

zephyr_library_include_directories(
  ${CMAKE_CURRENT_SOURCE_DIR}/mock/
  ${CMAKE_CURRENT_SOURCE_DIR}/../../src/modules/fw_upgrade
  ${CMAKE_CURRENT_SOURCE_DIR}/../../src/events/fw_upgrade
  ${CMAKE_CURRENT_SOURCE_DIR}/../../src/events/power_manager/
  ${CMAKE_CURRENT_SOURCE_DIR}/../../src/events/error_handler/
  ${CMAKE_CURRENT_SOURCE_DIR}/../../src/events/diagnostics
  ${CMAKE_CURRENT_SOURCE_DIR}/../../src/drivers/gnss/zephyr
  ${CMAKE_CURRENT_SOURCE_DIR}/../../src/modules/diagnostics
  ${CMAKE_CURRENT_SOURCE_DIR}/../../src/modules/storage_controller
  ${CMAKE_CURRENT_SOURCE_DIR}/../../src/drivers/modem_nf/zephyr/
)
```

## Kconfig
```
menu "APPLICATION_CODE"
	menu "FW_UPGRADE"
    	rsource "./../../src/modules/fw_upgrade/Kconfig"
    	rsource "./../../src/events/fw_upgrade/Kconfig"
	endmenu # FW_UPGRADE

	menu "ERROR_HANDLER"
    	rsource "./../../src/modules/error_handler/Kconfig"
	endmenu
endmenu # APPLICATION CODE

menu "Zephyr Kernel"
source "Kconfig.zephyr"
endmenu
```

## prj.conf
```kconfig
#
# Copyright (c) 2022 Nofence AS
#

CONFIG_ZTEST=y
CONFIG_ZTEST_MOCKING=y
CONFIG_ZTEST_PARAMETER_COUNT=20

# Configuration required by Event Manager
CONFIG_EVENT_MANAGER=y
CONFIG_LINKER_ORPHAN_SECTION_PLACE=y
CONFIG_SYSTEM_WORKQUEUE_STACK_SIZE=8192
CONFIG_HEAP_MEM_POOL_SIZE=8192

CONFIG_REBOOT=y
```

## src/firmware_upgrade_test.c
```c
/*
 * Copyright (c) 2022 Nofence AS
 */

#include <ztest.h>
#include "fw_upgrade.h"
#include "fw_upgrade_events.h"
#include "error_event.h"
#include <net/fota_download.h>

static K_SEM_DEFINE(test_status, 0, 1);

enum test_event_id {
	TEST_EVENT_INIT = 0,
	TEST_EVENT_START = 1,
	TEST_EVENT_PROGRESS = 2,
	TEST_EVENT_REBOOT = 3,
	TEST_EVENT_ERROR_IN_DL = 4,
	TEST_EVENT_ERROR_START_DL = 5
};

static enum test_event_id cur_id = TEST_EVENT_INIT;

/* Provide custom assert post action handler to handle the assertion on OOM
 * error in Event Manager.
 */
BUILD_ASSERT(!IS_ENABLED(CONFIG_ASSERT_NO_FILE_INFO));
void assert_post_action(const char *file, unsigned int line)
{
	printk("assert_post_action - file: %s (line: %u)\n", file, line);
}

void setup_init(void)
{
	cur_id = TEST_EVENT_INIT;
	ztest_returns_value(fota_download_init, 0);
	k_sem_take(&test_status, K_SECONDS(30));
}

void test_init(void)
{
	zassert_false(event_manager_init(), "Error when initializing event manager");
	zassert_false(fw_upgrade_module_init(), "Error when initializing firmware upgrade module");
	/* See if we get the 'IDLE' flag as it should be after init. */
	int err = k_sem_take(&test_status, K_SECONDS(30));
	zassert_equal(err, 0, "Test status event execution \
		hanged waiting for IDLE.");
}

void setup_start_fota(void)
{
	cur_id = TEST_EVENT_START;
	ztest_returns_value(fota_download_start, 0);
	k_sem_take(&test_status, K_SECONDS(30));
}

void test_start_fota(void)
{
	struct start_fota_event *ev = new_start_fota_event();
	ev->override_default_host = false;
	ev->version = 2001;
	EVENT_SUBMIT(ev);

	/* See if we get the 'REBOOT' flag as it should be after init. */
	int err = k_sem_take(&test_status, K_SECONDS(30));
	zassert_equal(err, 0, "Test status event execution \
		hanged waiting for REBOOT.");
}

void setup_start_fota_error_in_download(void)
{
	cur_id = TEST_EVENT_ERROR_IN_DL;
	ztest_returns_value(fota_download_start, 0);
	k_sem_take(&test_status, K_SECONDS(30));
}

/* Start same fota test, but now the fota_download module outputs error. */
void test_start_fota_error_in_download(void)
{
	struct start_fota_event *ev = new_start_fota_event();
	ev->override_default_host = false;
	ev->version = 2001;
	EVENT_SUBMIT(ev);

	/* See if we get the error DFU status flag. */
	int err = k_sem_take(&test_status, K_SECONDS(30));
	zassert_equal(err, 0, "Test status event execution \
		hanged waiting for error.");
}

void setup_error_start_download(void)
{
	cur_id = TEST_EVENT_ERROR_START_DL;
	ztest_returns_value(fota_download_start, -ENOTCONN);
	k_sem_take(&test_status, K_SECONDS(30));
}

/* Start same fota test, but now the fota_download module outputs error. */
void test_start_fota_error_start_download(void)
{
	struct start_fota_event *ev = new_start_fota_event();
	ev->override_default_host = false;
	ev->version = 2001;
	EVENT_SUBMIT(ev);

	/** Should not see it on the event bus, since we do not want to
	  * hangup the thread. 
	  */
	int err = k_sem_take(&test_status, K_SECONDS(30));
	zassert_not_equal(err, 0, "");
}

void teardown_common(void)
{
	/* Ensure other threads in use have time to finish what they're doing.
	 * This does makes no difference to threads that are coopartive (<-1)
	 */
	k_sleep(K_SECONDS(30));
}

void test_main(void)
{
	ztest_test_suite(
		firmware_upgrade_tests,
		ztest_unit_test_setup_teardown(test_init, setup_init, teardown_common),
		ztest_unit_test_setup_teardown(test_start_fota, setup_start_fota, teardown_common),
		ztest_unit_test_setup_teardown(test_start_fota_error_in_download,
					       setup_start_fota_error_in_download, teardown_common),
		ztest_unit_test_setup_teardown(test_start_fota_error_start_download,
					       setup_error_start_download, teardown_common));

	ztest_run_test_suite(firmware_upgrade_tests);
}

static bool event_handler(const struct event_header *eh)
{
	if (is_dfu_status_event(eh)) {
		struct dfu_status_event *ev = cast_dfu_status_event(eh);
		if (cur_id == TEST_EVENT_INIT) {
			zassert_equal(ev->dfu_status, DFU_STATUS_IDLE,
				      "Status not idle as it should after init.");
			k_sem_give(&test_status);
			cur_id = TEST_EVENT_START;
		} else if (cur_id == TEST_EVENT_START) {
			zassert_equal(ev->dfu_status, DFU_STATUS_IN_PROGRESS, "");
			zassert_equal(ev->dfu_error, 0, "");
			cur_id = TEST_EVENT_PROGRESS;
			/* Simualte all fragments have been transferred. */
			simulate_callback_event();
		} else if (cur_id == TEST_EVENT_PROGRESS) {
			zassert_equal(ev->dfu_status, DFU_STATUS_SUCCESS_REBOOT_SCHEDULED, "");
			zassert_equal(ev->dfu_error, 0, "");
			cur_id = TEST_EVENT_REBOOT;
			k_sem_give(&test_status);
		} else if (cur_id == TEST_EVENT_ERROR_IN_DL) {
			zassert_equal((int)ev->dfu_status,
				      (int)FOTA_DOWNLOAD_ERROR_CAUSE_DOWNLOAD_FAILED, "");
			k_sem_give(&test_status);
		}
		return false;
	}
	if (is_error_event(eh)) {
		struct error_event *ev = cast_error_event(eh);
		zassert_equal(ev->sender, ERR_FW_UPGRADE, "Wrong sender expected.");

		if (cur_id == TEST_EVENT_ERROR_START_DL) {
			zassert_equal(ev->code, -ENOTCONN, "");
			zassert_equal(ev->severity, ERR_SEVERITY_ERROR, "");

			char *expected = "Unable to start FOTA DL";
			zassert_equal(ev->dyndata.size, strlen(expected), "");
			zassert_mem_equal(ev->dyndata.data, expected, strlen(expected), "");
			k_sem_give(&test_status);
		} else {
			zassert_unreachable("Unexpected error triggered.");
		}
		return false;
	}
	zassert_true(false, "Wrong event type received");
	return false;
}

EVENT_LISTENER(test_main, event_handler);
EVENT_SUBSCRIBE(test_main, dfu_status_event);
EVENT_SUBSCRIBE(test_main, error_event);
```
