## CMakeLists.txt
```
#
# Copyright (c) 2022 Nofence AS
#

cmake_minimum_required(VERSION 3.20.0)

list(APPEND ZEPHYR_EXTRA_MODULES
        ${CMAKE_CURRENT_SOURCE_DIR}/../../src/modules/collar_protocol
        )
        
find_package(Zephyr REQUIRED HINTS $ENV{ZEPHYR_BASE})
project(error_handler_testing)

zephyr_include_directories(${CMAKE_CURRENT_BINARY_DIR})
include_directories(${CMAKE_CURRENT_BINARY_DIR})

FILE(GLOB app_sources 
  ${CMAKE_CURRENT_SOURCE_DIR}/src/*.c 
  ${CMAKE_CURRENT_SOURCE_DIR}/../../src/events/watchdog/*.c
)
target_sources(app PRIVATE ${app_sources})
target_include_directories(app PRIVATE ${APP_SOURCE})

zephyr_library_include_directories(
  ${CMAKE_CURRENT_SOURCE_DIR}/../../src/events/watchdog
)
add_dependencies(app collar_protocol_headers)
```

## Kconfig
```
menu "APPLICATION_CODE"
	menu "WATCHDOG"
    	rsource "./../../src/modules/watchdog/Kconfig"
	endmenu # WATCHDOG

	menu "BLE"
	rsource "./../../src/modules/ble/Kconfig"
	endmenu # BLE


endmenu # APPLICATION CODE

menu "Zephyr Kernel"
source "Kconfig.zephyr"
endmenu
```

## prj.conf
```kconfig
#
# Copyright (c) 2022 Nofence AS
#

CONFIG_ZTEST=y

# Configuration required by Event Manager
CONFIG_EVENT_MANAGER=y
CONFIG_LINKER_ORPHAN_SECTION_PLACE=y
CONFIG_SYSTEM_WORKQUEUE_STACK_SIZE=8192
CONFIG_HEAP_MEM_POOL_SIZE=8192
CONFIG_REBOOT=y
CONFIG_COLLAR_PROTOCOL=y

CONFIG_WATCHDOG_ENABLE=y
CONFIG_BEACON_SCAN_ENABLE=y
```

## src/watchdog_test.c
```c
/*
 * Copyright (c) 2022 Nofence AS
 */

#include <ztest.h>
#include "watchdog_event.h"
#include <stdio.h>
#include <string.h>

static K_SEM_DEFINE(watchdog_feed_sem, 0, 1);

uint8_t module_alive_array_seen[WDG_END_OF_LIST];

/* Provide custom assert post action handler to handle the assertion on OOM
 * error in Event Manager.
 */
BUILD_ASSERT(!IS_ENABLED(CONFIG_ASSERT_NO_FILE_INFO));
void assert_post_action(const char *file, unsigned int line)
{
	printk("assert_post_action - file: %s (line: %u)\n", file, line);
}

void test_init(void)
{
	zassert_false(event_manager_init(), "Error when initializing event manager");
}

void test_wathcdog_feed(void)
{
	memset(module_alive_array_seen, 0, sizeof(module_alive_array_seen));
	watchdog_report_module_alive(WDG_PWR_MODULE);
	watchdog_report_module_alive(WDG_BLE_SCAN);
	int err = k_sem_take(&watchdog_feed_sem, K_SECONDS(CONFIG_WATCHDOG_TIMEOUT_SEC));
	zassert_equal(err, 0, "Watchdog feed error");
}

void test_wathcdog_timeout(void)
{
	memset(module_alive_array_seen, 0, sizeof(module_alive_array_seen));
	watchdog_report_module_alive(WDG_PWR_MODULE);
	memset(module_alive_array_seen, 0, sizeof(module_alive_array_seen));
	int err = k_sem_take(&watchdog_feed_sem, K_SECONDS(CONFIG_WATCHDOG_TIMEOUT_SEC));
	zassert_equal(err, -EAGAIN, "Timeout test error");
}

void test_main(void)
{
	ztest_test_suite(watchdog_handler_tests, ztest_unit_test(test_init),
			 ztest_unit_test(test_wathcdog_feed),
			 ztest_unit_test(test_wathcdog_timeout));

	ztest_run_test_suite(watchdog_handler_tests);
}

uint8_t expected_array_seen[WDG_END_OF_LIST] = { [0 ... WDG_END_OF_LIST - 1] = 1 };

static bool event_handler(const struct event_header *eh)
{
	if (is_watchdog_alive_event(eh)) {
		struct watchdog_alive_event *ev = cast_watchdog_alive_event(eh);
		if (ev->magic == WATCHDOG_ALIVE_MAGIC) {
			if (ev->module < WDG_END_OF_LIST) {
				module_alive_array_seen[ev->module] = 1;
				int ret = memcmp(module_alive_array_seen, expected_array_seen,
						 WDG_END_OF_LIST);
				if (ret == 0) {
					printk("All modules alive. Feeding watchdog.\n");
					k_sem_give(&watchdog_feed_sem);
				}
			}
		}
		return false;
	}
	zassert_true(false, "Unexpected event type received");
	return false;
}

EVENT_LISTENER(test_main, event_handler);
EVENT_SUBSCRIBE(test_main, watchdog_alive_event);
```
