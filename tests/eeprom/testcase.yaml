## tests/electric_pulse/testcase.yaml
```yaml
tests:
  electric_pulse.test:
    platform_allow: native_posix
    tags: event_manager
```

## tests/environment/testcase.yaml
```yaml
tests:
  env_sensor.test:
    platform_allow: native_posix
    tags: event_manager
```

## tests/error_handler/testcase.yaml
```yaml
tests:
  error_handler.test:
    platform_allow: native_posix
    tags: event_manager
```

## tests/event_manager/testcase.yaml
```yaml
tests:
  event_manager.core:
    platform_allow: native_posix
    tags: event_manager
```

## tests/firmware_upgrade/testcase.yaml
```yaml
tests:
  firmware_upgrade.test:
    platform_allow: native_posix
    tags: event_manager
```

## tests/flash/testcase.yaml
```yaml
common:
  integration_platforms:
    - nrf52840dk_nrf52840

tests:
  drivers.flash.nrf_qspi_nor:
    platform_allow: nrf52840dk_nrf52840
    tags: flash nrf52 nrf_qspi_fash
    extra_args: OVERLAY_CONFIG=boards/nrf52840_flash_qspi.conf
```

## tests/messaging/testcase.yaml
```yaml
tests:
  messaging.test:
    platform_allow: native_posix
    tags: event_manager
```

## tests/power_manager/testcase.yaml
```yaml
tests:
  power_manager.test:
    platform_allow: native_posix
    tags: event_manager
```
