## CMakeLists.txt
```
#
# Copyright (c) 2022 Nofence AS
#

cmake_minimum_required(VERSION 3.20.0)

find_package(Zephyr REQUIRED HINTS $ENV{ZEPHYR_BASE})
project(buzzer_testing)

zephyr_include_directories(${CMAKE_CURRENT_BINARY_DIR})
include_directories(${CMAKE_CURRENT_BINARY_DIR})

FILE(GLOB app_sources 
  ${CMAKE_CURRENT_SOURCE_DIR}/src/*.c 
  ${CMAKE_CURRENT_SOURCE_DIR}/mock/drivers/*.c 
  ${CMAKE_CURRENT_SOURCE_DIR}/../../src/modules/buzzer/*.c
  ${CMAKE_CURRENT_SOURCE_DIR}/../../src/events/buzzer/*.c
  ${CMAKE_CURRENT_SOURCE_DIR}/../../src/events/error_handler/*.c
)
target_sources(app PRIVATE ${app_sources})
target_include_directories(app PRIVATE ${APP_SOURCE})

zephyr_library_include_directories(
  ${CMAKE_CURRENT_SOURCE_DIR}/mock
  ${CMAKE_CURRENT_SOURCE_DIR}/../../src/modules/buzzer
  ${CMAKE_CURRENT_SOURCE_DIR}/../../src/events/buzzer
  ${CMAKE_CURRENT_SOURCE_DIR}/../../src/events/pwr_event
  ${CMAKE_CURRENT_SOURCE_DIR}/../../src/events/error_handler
)
```

## Kconfig
```
menu "APPLICATION_CODE"
	menu "BUZZER_MODULE"
    	rsource "./../../src/modules/buzzer/Kconfig"
	endmenu # BUZZER_MODULE
	menu "ERROR_HANDLER"
    	rsource "./../../src/modules/error_handler/Kconfig"
	endmenu # ERROR_HANDLER
endmenu # APPLICATION CODE

menu "Zephyr Kernel"
source "Kconfig.zephyr"
endmenu
```

## prj.conf
```kconfig
#
# Copyright (c) 2022 Nofence AS
#

CONFIG_ZTEST=y
CONFIG_ZTEST_MOCKING=y

# Might be some better way to do this than allocating all mock values expected
# from the song being tested. SND_WELCOME has over 16,000 mock calls to PWM_PIN_SET
CONFIG_ZTEST_PARAMETER_COUNT=32768

# Configuration required by Event Manager
CONFIG_EVENT_MANAGER=y
CONFIG_LINKER_ORPHAN_SECTION_PLACE=y
CONFIG_SYSTEM_WORKQUEUE_STACK_SIZE=8192
CONFIG_HEAP_MEM_POOL_SIZE=8192
CONFIG_REBOOT=y

CONFIG_PWM=n

CONFIG_GPIO=y
CONFIG_GPIO_EMUL=y
```

## boards/native_posix.overlay
```dts
/ {
        aliases {
                dummy-buzzer = &gpio0;
        };
};
```

## src/buzzer_test.c
```c
/*
 * Copyright (c) 2022 Nofence AS
 */

#include <ztest.h>
#include "buzzer.h"
#include "sound_event.h"
#include <event_manager.h>
#include <stdio.h>
#include <string.h>
#include <drivers/pwm.h>
#include "melodies.h"

#include "buzzer_test.h"

#include "error_event.h"

K_SEM_DEFINE(sound_idle_sem, 0, 1);
K_SEM_DEFINE(sound_playing_sem, 0, 1);
K_SEM_DEFINE(sound_playing_warn_sem, 0, 1);
K_SEM_DEFINE(sound_playing_max_sem, 0, 1);

K_SEM_DEFINE(error_timeout_sem, 0, 1);
K_SEM_DEFINE(freq_event_sem, 0, 1);

/** @brief Helper function for expecting pulse and period as pwm_pin_set. 
 *         Expects duty cycle of 50%. Also always expects pwm pins to be
 *         set to 0 again after being played.
*/
void mock_expect_pwm_hz(uint32_t freq)
{
	uint32_t period = freq == 0 ? 0 : 1000000 / freq;
	/* Expect to set to 0 after note was played. */
	ztest_returns_value(pwm_pin_set_usec, 0);
	ztest_expect_value(pwm_pin_set_usec, pulse, period / 2);
	ztest_expect_value(pwm_pin_set_usec, period, period);

	ztest_returns_value(pwm_pin_set_usec, 0);
	ztest_expect_value(pwm_pin_set_usec, pulse, 0);
	ztest_expect_value(pwm_pin_set_usec, period, 0);
}

void test_init_event_manager(void)
{
	zassert_false(event_manager_init(), "Error when initializing event manager");
}
void test_init_buzzer(void)
{
	ztest_returns_value(pwm_get_cycles_per_sec, 0);
	zassert_false(buzzer_module_init(), "Error when initializing buzzer");

	/* Should publish sound IDLE event, wait for the semaphore. */
	int err = k_sem_take(&sound_idle_sem, K_SECONDS(30));
	zassert_equal(err, 0, "");
}

void test_perspelmann(void)
{
	/* Check if we get the expected song. */
	for (int i = 0; i < n_perspelmann_notes; i++) {
		mock_expect_pwm_hz(m_perspelmann[i].t);
	}

	struct sound_event *ev = new_sound_event();
	ev->type = SND_PERSPELMANN;
	EVENT_SUBMIT(ev);

	/* Wait for playing event, then idle event when it finishes. */
	int err = k_sem_take(&sound_playing_sem, K_SECONDS(30));
	zassert_equal(err, 0, "");

	err = k_sem_take(&sound_idle_sem, K_SECONDS(30));
	zassert_equal(err, 0, "");
}

void test_find_me(void)
{
	/* Check if we get the expected song. */
	for (int i = 0; i < n_geiterams_notes; i++) {
		mock_expect_pwm_hz(m_geiterams[i].t);
	}

	struct sound_event *ev = new_sound_event();
	ev->type = SND_FIND_ME;
	EVENT_SUBMIT(ev);

	/* Wait for playing event, then idle event when it finishes. */
	int err = k_sem_take(&sound_playing_sem, K_SECONDS(30));
	zassert_equal(err, 0, "");

	err = k_sem_take(&sound_idle_sem, K_SECONDS(30));
	zassert_equal(err, 0, "");
}

void test_setupmode(void)
{
	/* Check if we get the expected song. */
	for (int i = 0; i < n_setupmode_notes; i++) {
		mock_expect_pwm_hz(m_setupmode[i].t);
	}

	struct sound_event *ev = new_sound_event();
	ev->type = SND_SETUPMODE;
	EVENT_SUBMIT(ev);

	/* Wait for playing event, then idle event when it finishes. */
	int err = k_sem_take(&sound_playing_sem, K_SECONDS(30));
	zassert_equal(err, 0, "");

	err = k_sem_take(&sound_idle_sem, K_SECONDS(30));
	zassert_equal(err, 0, "");
}

void test_play_cattle(void)
{
	int i = 250;
	mock_expect_pwm_hz(i);

	for (; i < 400; i += 1) {
		mock_expect_pwm_hz(i);
	}

	mock_expect_pwm_hz(i);

	for (; i > 250; i -= 3) {
		mock_expect_pwm_hz(i);
	}

	mock_expect_pwm_hz(i);

	struct sound_event *ev = new_sound_event();
	ev->type = SND_CATTLE;
	EVENT_SUBMIT(ev);

	/* Wait for playing event, then idle event when it finishes. */
	int err = k_sem_take(&sound_playing_sem, K_SECONDS(30));
	zassert_equal(err, 0, "");

	err = k_sem_take(&sound_idle_sem, K_SECONDS(30));
	zassert_equal(err, 0, "");
}

void test_short_100(void)
{
	mock_expect_pwm_hz(1000);

	struct sound_event *ev = new_sound_event();
	ev->type = SND_SHORT_100;
	EVENT_SUBMIT(ev);

	/* Wait for playing event, then idle event when it finishes. */
	int err = k_sem_take(&sound_playing_sem, K_SECONDS(30));
	zassert_equal(err, 0, "");

	err = k_sem_take(&sound_idle_sem, K_SECONDS(30));
	zassert_equal(err, 0, "");
}

void test_short_200(void)
{
	mock_expect_pwm_hz(100);

	struct sound_event *ev = new_sound_event();
	ev->type = SND_SHORT_200;
	EVENT_SUBMIT(ev);

	/* Wait for playing event, then idle event when it finishes. */
	int err = k_sem_take(&sound_playing_sem, K_SECONDS(30));
	zassert_equal(err, 0, "");

	err = k_sem_take(&sound_idle_sem, K_SECONDS(30));
	zassert_equal(err, 0, "");
}

void test_solar_test(void)
{
	mock_expect_pwm_hz(tone_c_6);
	mock_expect_pwm_hz(0);
	mock_expect_pwm_hz(tone_g_6);

	struct sound_event *ev = new_sound_event();
	ev->type = SND_SOLAR_TEST;
	EVENT_SUBMIT(ev);

	/* Wait for playing event, then idle event when it finishes. */
	int err = k_sem_take(&sound_playing_sem, K_SECONDS(30));
	zassert_equal(err, 0, "");

	err = k_sem_take(&sound_idle_sem, K_SECONDS(30));
	zassert_equal(err, 0, "");
}

void test_off(void)
{
	ztest_returns_value(pwm_pin_set_usec, 0);
	ztest_expect_value(pwm_pin_set_usec, pulse, 0);
	ztest_expect_value(pwm_pin_set_usec, period, 0);

	struct sound_event *ev = new_sound_event();
	ev->type = SND_OFF;
	EVENT_SUBMIT(ev);

	int err = k_sem_take(&sound_idle_sem, K_SECONDS(30));
	zassert_equal(err, 0, "");
}

/** @brief Tests if the first sound played is aborted due to higher priority
 *         requested on second event publish.
 *
*/
void test_priority_second_prio(void)
{
	/* Check if we get the expected song FIND_ME. */
	for (int i = 0; i < n_geiterams_notes; i++) {
		mock_expect_pwm_hz(m_geiterams[i].t);
	}

	struct sound_event *ev = new_sound_event();
	ev->type = SND_PERSPELMANN;
	EVENT_SUBMIT(ev);

	/* Uncommenting this will result in expected error that proves
	 * it's working as expected. However, it's not possible to
	 * negative assert ztest_expect_value if we get unusued param,
	 * but it shows that the first sound is played as 
	 * expected, and then overwritten by the next request.
	 */
	//k_sleep(K_SECONDS(5));

	struct sound_event *ev_find_me = new_sound_event();
	ev_find_me->type = SND_FIND_ME;
	EVENT_SUBMIT(ev_find_me);

	/* Wait for playing event, then idle event when it finishes. */
	int err = k_sem_take(&sound_playing_sem, K_SECONDS(30));
	zassert_equal(err, 0, "");

	err = k_sem_take(&sound_idle_sem, K_SECONDS(30));
	zassert_equal(err, 0, "");
}

/** @brief Tests if the first sound is NOT aborted due 
 *         to higher priority being played
 *         already. 
 */
void test_priority_first_prio(void)
{
	/* Check if we get the expected song FIND_ME. */
	for (int i = 0; i < n_geiterams_notes; i++) {
		mock_expect_pwm_hz(m_geiterams[i].t);
	}

	struct sound_event *ev_find_me = new_sound_event();
	ev_find_me->type = SND_FIND_ME;
	EVENT_SUBMIT(ev_find_me);

	struct sound_event *ev = new_sound_event();
	ev->type = SND_PERSPELMANN;
	EVENT_SUBMIT(ev);

	/* Wait for playing event, then idle event when it finishes. */
	int err = k_sem_take(&sound_playing_sem, K_SECONDS(30));
	zassert_equal(err, 0, "");

	err = k_sem_take(&sound_idle_sem, K_SECONDS(30));
	zassert_equal(err, 0, "");
}

void setup_common(void)
{
	/* Take all semaphores to ensure they need
	 * to be given from the tested module prior to the tests that need them. 
	 */
	k_sem_take(&sound_idle_sem, K_SECONDS(30));
	k_sem_take(&sound_playing_sem, K_SECONDS(30));
	k_sem_take(&sound_playing_max_sem, K_SECONDS(30));
	k_sem_take(&error_timeout_sem, K_SECONDS(30));
	k_sem_take(&freq_event_sem, K_SECONDS(30));
}

void teardown_common(void)
{
	k_sleep(K_SECONDS(30));
}

void test_main(void)
{
	ztest_test_suite(
		buzzer_tests, ztest_unit_test(test_init_event_manager),
		ztest_unit_test_setup_teardown(test_init_buzzer, setup_common, teardown_common),
		ztest_unit_test_setup_teardown(test_perspelmann, setup_common, teardown_common),
		ztest_unit_test_setup_teardown(test_find_me, setup_common, teardown_common),
		ztest_unit_test_setup_teardown(test_setupmode, setup_common, teardown_common),
		ztest_unit_test_setup_teardown(test_play_cattle, setup_common, teardown_common),
		ztest_unit_test_setup_teardown(test_short_100, setup_common, teardown_common),
		ztest_unit_test_setup_teardown(test_short_200, setup_common, teardown_common),
		ztest_unit_test_setup_teardown(test_solar_test, setup_common, teardown_common),
		ztest_unit_test_setup_teardown(test_off, setup_common, teardown_common),
		ztest_unit_test_setup_teardown(test_priority_second_prio, setup_common,
					       teardown_common),
		ztest_unit_test_setup_teardown(test_priority_first_prio, setup_common,
					       teardown_common),
		ztest_unit_test_setup_teardown(test_warn_zone_init, setup_common, teardown_common),
		ztest_unit_test_setup_teardown(test_warn_zone_timeout, setup_common,
					       teardown_common),
		ztest_unit_test_setup_teardown(test_warn_zone_play_until_range, setup_common,
					       teardown_common));

	ztest_run_test_suite(buzzer_tests);
}

static bool event_handler(const struct event_header *eh)
{
	if (is_sound_status_event(eh)) {
		struct sound_status_event *ev = cast_sound_status_event(eh);
		if (ev->status == SND_STATUS_IDLE) {
			k_sem_give(&sound_idle_sem);
		} else if (ev->status == SND_STATUS_PLAYING) {
			k_sem_give(&sound_playing_sem);
		} else if (ev->status == SND_STATUS_PLAYING_WARN) {
			k_sem_give(&sound_playing_warn_sem);
		} else if (ev->status == SND_STATUS_PLAYING_MAX) {
			k_sem_give(&sound_playing_max_sem);
		}
		return false;
	}
	if (is_error_event(eh)) {
		struct error_event *ev = cast_error_event(eh);
		if (ev->code == -ETIMEDOUT) {
			k_sem_give(&error_timeout_sem);
		}
		return false;
	}
	if (is_sound_set_warn_freq_event(eh)) {
		k_sem_give(&freq_event_sem);
		return false;
	}
	zassert_true(false, "Unexpected event type received");
	return false;
}

EVENT_LISTENER(test_main, event_handler);
EVENT_SUBSCRIBE(test_main, sound_status_event);
EVENT_SUBSCRIBE(test_main, error_event);
EVENT_SUBSCRIBE_FINAL(test_main, sound_set_warn_freq_event);
```

## src/buzzer_test.h
```c
/*
 * Copyright (c) 2022 Nofence AS
 */

#ifndef _BUZZER_TEST_H_
#define _BUZZER_TEST_H_

#include <zephyr.h>
#include "sound_event.h"

void test_warn_zone_init(void);
void test_warn_zone_timeout(void);
void test_warn_zone_play_until_range(void);

extern struct k_sem sound_idle_sem;
extern struct k_sem sound_playing_sem;
extern struct k_sem sound_playing_warn_sem;
extern struct k_sem sound_playing_max_sem;
extern struct k_sem error_timeout_sem;
extern struct k_sem freq_event_sem;

void mock_expect_pwm_hz(uint32_t freq);

#endif /* _BUZZER_TEST_H_ */
```

## src/warn_zone_test.c
```c
/*
 * Copyright (c) 2022 Nofence AS
 */

#include <ztest.h>
#include "buzzer.h"
#include "sound_event.h"
#include <event_manager.h>
#include <stdio.h>
#include <string.h>
#include <drivers/pwm.h>
#include "melodies.h"

#include "buzzer_test.h"

/* This test tries to run the warn_zone event without setting the
 * frequency event first. We should expect the sound controller to play the
 * init frequency for the timeout duration since we do not give it any updates.
 */
void test_warn_zone_init(void)
{
	mock_expect_pwm_hz(WARN_FREQ_INIT);

	struct sound_event *ev = new_sound_event();
	ev->type = SND_WARN;
	EVENT_SUBMIT(ev);

	/* We should get playing warn event 
	 * since we just issued the event.
	 */
	int err = k_sem_take(&sound_playing_warn_sem, K_SECONDS(30));
	zassert_equal(err, 0, "");

	/* We should timeout here, since we do not get a new frequency update. */
	err = k_sem_take(&error_timeout_sem, K_SECONDS(30));
	zassert_equal(err, 0, "Didn't timeout as expected!");

	/* Finish with playing IDLE. */
	err = k_sem_take(&sound_idle_sem, K_SECONDS(30));
	zassert_equal(err, 0, "");
}

/* Tests that we can set a frequency to the warn zone variable, but we will
 * timeout, since we do not update it within the necessary timeout interval
 * a second time. Also tests to set frequency before SND_WARN event
 * and see the correct frequency is still played.
 */
void test_warn_zone_timeout(void)
{
	/* Issue warn zone, will start playing initial frequency. */
	mock_expect_pwm_hz(WARN_FREQ_INIT);

	struct sound_event *ev = new_sound_event();
	ev->type = SND_WARN;
	EVENT_SUBMIT(ev);

	/* Wait for playing warn zone event. */
	int err = k_sem_take(&sound_playing_warn_sem, K_SECONDS(30));
	zassert_equal(err, 0, "");

	/* Play MAX event. */
	mock_expect_pwm_hz(WARN_FREQ_MAX);

	struct sound_set_warn_freq_event *ef = new_sound_set_warn_freq_event();
	ef->freq = WARN_FREQ_MAX;
	EVENT_SUBMIT(ef);

	/* Wait for playing MAX event. */
	err = k_sem_take(&sound_playing_max_sem, K_SECONDS(30));
	zassert_equal(err, 0, "");

	/* Wait for playing idle event which should happen as we timeout. */
	err = k_sem_take(&sound_idle_sem, K_SECONDS(30));
	zassert_equal(err, 0, "");

	/* Take error_timeout_sem, we should be given this, as we expect a
	 * timeout.
	 */
	err = k_sem_take(&error_timeout_sem, K_SECONDS(30));
	zassert_equal(err, 0, "Should timeout in this test.");
}

/* Plays the warn zone until we give sound controller a frequency
 * that is the SND_MAX. The sound controller should detect that this is the
 * max, so it publishes a SND_MAX status event. Finishes when we pass a
 * frequency that is outside the range.
 */
void test_warn_zone_play_until_range(void)
{
	int err;

	/* Issue new warn zone event. Expect INIT freq to be played. */
	mock_expect_pwm_hz(WARN_FREQ_INIT);

	struct sound_event *ev = new_sound_event();
	ev->type = SND_WARN;
	EVENT_SUBMIT(ev);

	/* Wait for playing warn zone event. */
	err = k_sem_take(&sound_playing_warn_sem, K_SECONDS(30));
	zassert_equal(err, 0, "");

	for (int i = WARN_FREQ_MAX; i > WARN_FREQ_INIT - 100; i -= 50) {
		if (i <= WARN_FREQ_MAX && i >= WARN_FREQ_INIT) {
			/* Only expect mocked values if its within range. */
			mock_expect_pwm_hz(i);
		}

		struct sound_set_warn_freq_event *ef = new_sound_set_warn_freq_event();
		ef->freq = i;
		EVENT_SUBMIT(ef);

		/* Make sure the event has been processed by sound controller. */
		err = k_sem_take(&freq_event_sem, K_SECONDS(30));
		zassert_equal(err, 0, "");
	}

	/* We should have been given this. */
	err = k_sem_take(&sound_playing_warn_sem, K_SECONDS(120));
	zassert_equal(err, 0, "");

	/* Wait for playing MAX event, we should get it once
	 * since we iterate ONCE through all frequencies from MIN to MAX. 
	 */
	err = k_sem_take(&sound_playing_max_sem, K_SECONDS(120));
	zassert_equal(err, 0, "");

	/* Wait for playing idle event. */
	err = k_sem_take(&sound_idle_sem, K_SECONDS(120));
	zassert_equal(err, 0, "");

	/* Take error_timeout_sem, we should not be given this, as we do not
	 * expect a timeout.
	 */
	err = k_sem_take(&error_timeout_sem, K_SECONDS(120));
	zassert_not_equal(err, 0, "");
}
```
