## CMakeLists.txt
```
# SPDX-License-Identifier: Apache-2.0

cmake_minimum_required(VERSION 3.20.0)

list(APPEND ZEPHYR_EXTRA_MODULES
        ${CMAKE_CURRENT_SOURCE_DIR}/../../src/modules/collar_protocol
        )

find_package(Zephyr REQUIRED HINTS $ENV{ZEPHYR_BASE})
project(bluetooth)

zephyr_include_directories(${CMAKE_CURRENT_BINARY_DIR})
include_directories(${CMAKE_CURRENT_BINARY_DIR})

FILE(GLOB app_sources
        ${CMAKE_CURRENT_SOURCE_DIR}/src/bluetooth.c
        ${CMAKE_CURRENT_SOURCE_DIR}/mock/*.c
        ${CMAKE_CURRENT_SOURCE_DIR}/../../src/events/ble/*.c
        ${CMAKE_CURRENT_SOURCE_DIR}/../../src/events/messaging/*.c
        ${CMAKE_CURRENT_SOURCE_DIR}/../../src/modules/ble/ble_controller.c
        ${CMAKE_CURRENT_SOURCE_DIR}/../../src/modules/ble/beacon_processor.c
        ${CMAKE_CURRENT_SOURCE_DIR}/../../src/events/watchdog/watchdog_event.c
        ${CMAKE_CURRENT_SOURCE_DIR}/../../src/events/error_handler/*.c
        ${CMAKE_CURRENT_SOURCE_DIR}/../../src/events/fw_upgrade/*.c
)

target_sources(app PRIVATE ${app_sources})
target_include_directories(app PRIVATE ${APP_SOURCE})

zephyr_library_include_directories(
  ${CMAKE_CURRENT_SOURCE_DIR}/mock/
  ${CMAKE_CURRENT_SOURCE_DIR}/../../include/
  ${CMAKE_CURRENT_SOURCE_DIR}/../../src/modules/ble
  ${CMAKE_CURRENT_SOURCE_DIR}/../../src/events/ble
  #${CMAKE_CURRENT_SOURCE_DIR}/../../src/modules/nf_settings/include
  ${CMAKE_CURRENT_SOURCE_DIR}/../../src/modules/storage_controller/
  ${CMAKE_CURRENT_SOURCE_DIR}/../../src/modules/messaging
  ${CMAKE_CURRENT_SOURCE_DIR}/../../src/events/messaging
  ${CMAKE_CURRENT_SOURCE_DIR}/../../src/events/watchdog
  ${CMAKE_CURRENT_SOURCE_DIR}/../../src/events/error_handler
  ${CMAKE_CURRENT_SOURCE_DIR}/../../src/events/fw_upgrade
)

add_dependencies(app collar_protocol_headers)
```

## Kconfig
```
menu "BLE"
rsource "./../../src/modules/ble/Kconfig"
endmenu # BLE

menu "ERROR_HANDLER"
rsource "./../../src/modules/error_handler/Kconfig"
endmenu # ERROR_HANDLER
menu "Zephyr Kernel"
source "Kconfig.zephyr"
endmenu

menu "FW_UPGRADE"
rsource "./../../src/modules/fw_upgrade/Kconfig"
rsource "./../../src/events/fw_upgrade/Kconfig"
endmenu # FW_UPGRADE

config BT_DEVICE_NAME
    string "Bluetooth device name"
    default "Zephyr"

config BT_L2CAP_TX_MTU
    int "MTU size"
    default 247
```

## prj.conf
```kconfig
CONFIG_ZTEST=y
CONFIG_ZTEST_MOCKING=y
CONFIG_ZTEST_PARAMETER_COUNT=20

# Configuration required by Event Manager
CONFIG_EVENT_MANAGER=y
CONFIG_LINKER_ORPHAN_SECTION_PLACE=y
CONFIG_SYSTEM_WORKQUEUE_STACK_SIZE=8192
CONFIG_HEAP_MEM_POOL_SIZE=8192
CONFIG_REBOOT=y

CONFIG_COLLAR_PROTOCOL=y

CONFIG_RING_BUFFER=y

CONFIG_BT_L2CAP_TX_MTU=247

CONFIG_BT_DEVICE_NAME="NF999999"

CONFIG_BEACON_PROCESSOR_LOG_LEVEL_INF=y

CONFIG_BEACON_SCAN_PERIODIC_INTERVAL=60
CONFIG_BEACON_SCAN_DURATION=14

CONFIG_COLLAR_PROTOCOL=y

CONFIG_BT_NUS=y
```

## src/beacon_processor_test.c
```c
#include <unity.h>
#include <beacon_processor.h>
#include <stdbool.h>
#include <nf_ble.h>


#define MAC1 {0x00, 0x01,0x02,0x03,0x04,0x05}
#define MAC2 {0x01, 0x01,0x02,0x03,0x04,0x05}
#define MAC3 {0x02, 0x01,0x02,0x03,0x04,0x05}
#define MAC4 {0x03, 0x01,0x02,0x03,0x04,0x05}
#define MAC5 {0x04, 0x01,0x02,0x03,0x04,0x05}
#define MAC6 {0x05, 0x01,0x02,0x03,0x04,0x05}

#define DEFAULT_EVT(MAC)  \
{\
        .evt_type = BLE_SCAN_BEACON_ADVERTISER_FOUND, \
        .rssi_sample_value = 56, \
        .mac_address.addr = MAC, \
        .adv_data = { \
                    .beacon_dev_type = 1, \
                    .major = Constants_BEACON_MAJOR_ID, \
                    .minor = Constants_BEACON_MINOR_ID, \
                    .rssi = 205,  \
                    .uuid = {0x01, 0x01,0x02,0x03,0x04,0x05,0x06,0x07,0x08,0x09,0x0A,0x0B,0x0C,0x0D,0x0E,0x0F} \
        } \
}

void setUp(void) {
}

/* Suite teardown shall finalize with mandatory call to generic_suiteTearDown. */
extern int generic_suiteTearDown(int num_failures);

int test_suiteTearDown(int num_failures) {
    return generic_suiteTearDown(num_failures);
}

void test_beacon_init(void) {
    beac_init();
}

#define UUID_1  BT_UUID_DECLARE_128(BT_UUID_128_ENCODE(0x6E400001, 0xB5A3, 0xF393, 0xE0A9, 0xE50E24DCCA9E))


void test_beacon_process_event() {
    beac_init();
    adv_data_t adv_data = {
            .major = BEACON_MAJOR_ID,
            .minor = BEACON_MINOR_ID,
            .rssi = 210,
            .uuid = {*(UUID_1)}
    };
    bt_addr_le_t addr1 = BT_ADDR_LE_ANY[0];
    addr1.a.val[0] = 0xDE;

    beac_process_event(0, &addr1, 56, &adv_data);
    SingleBeaconInfo_t *pInfo = beac_get_nearest_beacon(0);
    TEST_ASSERT_EQUAL(4, pInfo->calculated_dist);
}


void main(void) {
    extern void unity_main();
    (void) unity_main();
}
```

## src/beacon_processor_test.h
```c
/*
 * Copyright (c) 2019 Nordic Semiconductor ASA
 *
 * SPDX-License-Identifier: LicenseRef-Nordic-5-Clause
 */
#ifndef EXAMPLE_TEST_H_
#define EXAMPLE_TEST_H_

#include <sys/util.h>
#include <stdbool.h>


//#define ring_buf_put TODO

#ifdef NEVER
#undef IS_ENABLED
#define IS_ENABLED(x) runtime_##x

extern bool runtime_CONFIG_UUT_PARAM_CHECK;
#endif

#endif /* EXAMPLE_TEST_H_ */
```
