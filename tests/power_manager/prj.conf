## CMakeLists.txt
```
#
# Copyright (c) 2022 Nofence AS
#


cmake_minimum_required(VERSION 3.20.0)

list(APPEND ZEPHYR_EXTRA_MODULES
        ${CMAKE_CURRENT_SOURCE_DIR}/../../src/modules/collar_protocol
        )

find_package(Zephyr REQUIRED HINTS $ENV{ZEPHYR_BASE})
project(power_manager_tests)

zephyr_include_directories(
        ${CMAKE_CURRENT_BINARY_DIR}
)

include_directories(${CMAKE_CURRENT_BINARY_DIR})

FILE(GLOB app_sources 
        ${CMAKE_CURRENT_SOURCE_DIR}/mock/*.c
        ${CMAKE_CURRENT_SOURCE_DIR}/src/*.c 
        ${CMAKE_CURRENT_SOURCE_DIR}/../../src/events/power_manager/*.c
        ${CMAKE_CURRENT_SOURCE_DIR}/../../src/modules/power_manager/*.c
        ${CMAKE_CURRENT_SOURCE_DIR}/../../src/events/messaging/*.c
        ${CMAKE_CURRENT_SOURCE_DIR}/../../src/modules/power_manager/battery/battery.c
        ${CMAKE_CURRENT_SOURCE_DIR}/../../src/events/error_handler/error_event.c
        ${CMAKE_CURRENT_SOURCE_DIR}/../../src/events/buzzer/sound_event.c
        ${CMAKE_CURRENT_SOURCE_DIR}/../../src/events/ble/ble_ctrl_event.c
        ${CMAKE_CURRENT_SOURCE_DIR}/../../src/events/watchdog/watchdog_event.c
)
target_sources(app PRIVATE ${app_sources})
target_include_directories(app PRIVATE ${APP_SOURCE})

zephyr_library_include_directories(
  ${CMAKE_CURRENT_SOURCE_DIR}/mock
  ${CMAKE_CURRENT_SOURCE_DIR}/../../src/modules/power_manager
  ${CMAKE_CURRENT_SOURCE_DIR}/../../src/events/power_manager
  ${CMAKE_CURRENT_SOURCE_DIR}/../../src/events/messaging
  ${CMAKE_CURRENT_SOURCE_DIR}/../../src/events/error_handler
  ${CMAKE_CURRENT_SOURCE_DIR}/../../src/events/buzzer
  ${CMAKE_CURRENT_SOURCE_DIR}/../../src/modules/power_manager/battery/
  ${CMAKE_CURRENT_SOURCE_DIR}/../../src/events/ble
  ${CMAKE_CURRENT_SOURCE_DIR}/../../src/events/watchdog
  ${CMAKE_CURRENT_SOURCE_DIR}/../../include
  ${CMAKE_CURRENT_SOURCE_DIR}/../../src/modules/storage_controller/
  #${CMAKE_CURRENT_SOURCE_DIR}/../../src/modules/nf_settings/include
)

add_dependencies(app collar_protocol_headers)
```

## Kconfig
```
menu "APPLICATION_CODE"
	menu "ERROR_HANDLER"
    	rsource "./../../src/modules/error_handler/Kconfig"
	endmenu # ERROR_HANDLER

	menu "PWR_MODULE"
    	rsource "./../../src/modules/power_manager/Kconfig"
	endmenu # PWR_MODULE
endmenu # APPLICATION CODE

menu "Zephyr Kernel"
source "Kconfig.zephyr"
endmenu
```

## prj.conf
```kconfig
CONFIG_ZTEST=y
CONFIG_ZTEST_MOCKING=y
CONFIG_ZTEST_PARAMETER_COUNT=20

# Configuration required by Event Manager
CONFIG_EVENT_MANAGER=y
CONFIG_LINKER_ORPHAN_SECTION_PLACE=y
CONFIG_SYSTEM_WORKQUEUE_STACK_SIZE=8192
CONFIG_HEAP_MEM_POOL_SIZE=8192
CONFIG_REBOOT=y

CONFIG_ERROR_HANDLER_LOG_LEVEL=3

CONFIG_GPIO_EMUL=y
CONFIG_GPIO=y
CONFIG_ADC=y
CONFIG_ADC_EMUL=y
#CONFIG_BOARD_NATIVE_POSIX=y
CONFIG_BATTERY_POLLER_WORK_MSEC=2000
CONFIG_BATTERY_MOVING_AVERAGE_SAMPLES=1

CONFIG_COLLAR_PROTOCOL=y
```

## boards/native_posix.overlay
```dts
/*
 * Copyright 2021 Google LLC
 *
 * SPDX-License-Identifier: Apache-2.0
 */

/ {

	aliases {
		adc-0 = &adc0;
		
	};

	adc0: adc {
		compatible = "zephyr,adc-emul";
		nchannels = <2>;
		ref-internal-mv = <3300>;
		ref-external1-mv = <5000>;
		#io-channel-cells = <1>;
		label = "ADC_0";
		status = "okay";
	};
};
```

## src/power_manager_test.c
```c
/*
 * Copyright (c) 2022 Nofence AS
 */

#include <drivers/adc.h>
#include <drivers/adc/adc_emul.h>
#include <zephyr.h>
#include <ztest.h>
#include "pwr_event.h"
#include "pwr_module.h"
#include "error_event.h"

#define ADC_DEVICE_NAME DT_LABEL(DT_INST(0, zephyr_adc_emul))
#define ADC_REF_INTERNAL_MV DT_PROP(DT_INST(0, zephyr_adc_emul), ref_internal_mv)
#define ADC_REF_EXTERNAL1_MV DT_PROP(DT_INST(0, zephyr_adc_emul), ref_external1_mv)
#define ADC_RESOLUTION 14
#define ADC_ACQUISITION_TIME ADC_ACQ_TIME_DEFAULT
#define ADC_1ST_CHANNEL_ID 0
#define ADC_2ND_CHANNEL_ID 1

static K_SEM_DEFINE(normal_pwr_event_sem, 0, 1);
static K_SEM_DEFINE(low_pwr_event_sem, 0, 1);
static K_SEM_DEFINE(critical_pwr_event_sem, 0, 1);
static K_SEM_DEFINE(reboot_pwr_event_sem, 0, 1);

#define VOLTAGE_OFFSET_MV 100
/* Provide custom assert post action handler to handle the assertion on OOM
 * error in Event Manager.
 */
BUILD_ASSERT(!IS_ENABLED(CONFIG_ASSERT_NO_FILE_INFO));

const struct device *get_adc_device(void)
{
	const struct device *adc_dev = device_get_binding(ADC_DEVICE_NAME);

	zassert_not_null(adc_dev, "Cannot get ADC device");

	return adc_dev;
}

void assert_post_action(const char *file, unsigned int line)
{
	printk("assert_post_action - file: %s (line: %u)\n", file, line);
}

void test_event_manager_init(void)
{
	zassert_false(event_manager_init(), "Error when initializing event manager");
}

void test_pwr_module_init(void)
{
	/* Test with a givevn voltage */
	const uint16_t input_mv = 3800;
	/* Generic ADC setup */
	const struct device *adc_dev = get_adc_device();

	/* ADC emulator-specific setup */
	int ret = adc_emul_const_value_set(adc_dev, ADC_1ST_CHANNEL_ID, input_mv);
	zassert_ok(ret, "adc_emul_const_value_set() failed with code %d", ret);

	zassert_equal(pwr_module_init(), 0, "Error when initializing pwr module");

	/* Normal mode is initialized as default */
	int err = k_sem_take(&normal_pwr_event_sem, K_SECONDS(3));
	zassert_equal(err, 0, "normal_pwr_event_sem hanged.");
}

void test_pwr_module_normal(void)
{
	/* Test with a givevn voltage */
	const uint16_t input_mv = 3800;
	/* Generic ADC setup */
	const struct device *adc_dev = get_adc_device();

	/* ADC emulator-specific setup */
	int ret = adc_emul_const_value_set(adc_dev, ADC_1ST_CHANNEL_ID, input_mv);
	zassert_ok(ret, "adc_emul_const_value_set() failed with code %d", ret);

	int err = k_sem_take(&normal_pwr_event_sem, K_SECONDS(3));
	zassert_equal(err, 0, "normal_pwr_event_sem hanged.");
}

void test_pwr_module_low(void)
{
	const uint16_t input_mv = CONFIG_BATTERY_LOW - VOLTAGE_OFFSET_MV;
	/* Generic ADC setup */
	const struct device *adc_dev = get_adc_device();

	/* ADC emulator-specific setup */
	int ret = adc_emul_const_value_set(adc_dev, ADC_1ST_CHANNEL_ID, input_mv);
	zassert_ok(ret, "adc_emul_const_value_set() failed with code %d", ret);
	int err = k_sem_take(&low_pwr_event_sem, K_SECONDS(3));
	zassert_equal(err, 0, "low_pwr_event_sem hanged.");

	/* Check stuff when event is received here */
}

void test_pwr_module_critical(void)
{
	const uint16_t input_mv = CONFIG_BATTERY_CRITICAL - VOLTAGE_OFFSET_MV;
	/* Generic ADC setup */
	const struct device *adc_dev = get_adc_device();

	/* ADC emulator-specific setup */
	int ret = adc_emul_const_value_set(adc_dev, ADC_1ST_CHANNEL_ID, input_mv);
	zassert_ok(ret, "adc_emul_const_value_set() failed with code %d", ret);

	int err = k_sem_take(&critical_pwr_event_sem, K_SECONDS(3));
	zassert_equal(err, 0, "critical_pwr_event_sem hanged.");

	/* Check stuff when event is received here */
}

void test_pwr_module_normal_to_critical(void)
{
	const uint16_t input_mv = CONFIG_BATTERY_CRITICAL - VOLTAGE_OFFSET_MV;
	/* Generic ADC setup */
	const struct device *adc_dev = get_adc_device();

	/* ADC emulator-specific setup */
	int ret = adc_emul_const_value_set(adc_dev, ADC_1ST_CHANNEL_ID, input_mv);
	zassert_ok(ret, "adc_emul_const_value_set() failed with code %d", ret);

	int err = k_sem_take(&critical_pwr_event_sem, K_SECONDS(2));
	zassert_equal(err, -EAGAIN, "Error: jump directly to critical not allowed");

	err = k_sem_take(&critical_pwr_event_sem, K_SECONDS(3));
	zassert_equal(err, 0, "critical_pwr_event_sem hanged.");
}

void test_main(void)
{
	ztest_test_suite(pwr_tests, ztest_unit_test(test_event_manager_init),
			 ztest_unit_test(test_pwr_module_init),
			 ztest_unit_test(test_pwr_module_low),
			 ztest_unit_test(test_pwr_module_critical),
			 ztest_unit_test(test_pwr_module_low),
			 ztest_unit_test(test_pwr_module_normal),
			 ztest_unit_test(test_pwr_module_normal_to_critical));
	ztest_run_test_suite(pwr_tests);
}

static bool event_handler(const struct event_header *eh)
{
	if (is_pwr_status_event(eh)) {
		struct pwr_status_event *ev = cast_pwr_status_event(eh);
		switch (ev->pwr_state) {
		case PWR_NORMAL:
			printk("PWR NORMAL\n");
			/* Do nothing here */
			k_sem_give(&normal_pwr_event_sem);
			break;
		case PWR_LOW:
			printk("PWR LOW\n");
			/* Do nothing here */
			k_sem_give(&low_pwr_event_sem);
			break;
		case PWR_CRITICAL:
			printk("PWR CRTICAL\n");
			k_sem_give(&critical_pwr_event_sem);
			/* Do nothing here */
			break;
		default:
			zassert_unreachable("Unexpected command event.");
			break;
		}
	}
	if (is_pwr_reboot_event(eh)) {
		k_sem_give(&reboot_pwr_event_sem);
		return false;
	}
	if (is_error_event(eh)) {
		struct error_event *ev = cast_error_event(eh);
		switch (ev->sender) {
		case ERR_PWR_MODULE:
			zassert_equal(ev->code, -EACCES, "Mismatched error code.");
			break;

		default:
			zassert_unreachable("Unexpected command event.");
			break;
		}
	}
	return false;
}

EVENT_LISTENER(test_main, event_handler);
EVENT_SUBSCRIBE(test_main, pwr_status_event);
EVENT_SUBSCRIBE(test_main, error_event);
EVENT_SUBSCRIBE(test_main, pwr_reboot_event);
```
