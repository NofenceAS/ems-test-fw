## CMakeLists.txt
```
#
# Copyright (c) 2022 Nofence AS
#

cmake_minimum_required(VERSION 3.20.0)

list(APPEND ZEPHYR_EXTRA_MODULES
        ${CMAKE_CURRENT_SOURCE_DIR}/../../src/modules/collar_protocol
        )

find_package(Zephyr REQUIRED HINTS $ENV{ZEPHYR_BASE})
project(amc_testing)

zephyr_include_directories(${CMAKE_CURRENT_BINARY_DIR})
include_directories(${CMAKE_CURRENT_BINARY_DIR})

FILE(GLOB app_sources
        ${CMAKE_CURRENT_SOURCE_DIR}/src/*.c
        ${CMAKE_CURRENT_SOURCE_DIR}/mock/*.c
        ${CMAKE_CURRENT_SOURCE_DIR}/../../src/lib/trigonometry/trigonometry.c
        ${CMAKE_CURRENT_SOURCE_DIR}/../../src/lib/fifo/nf_fifo.c
        ${CMAKE_CURRENT_SOURCE_DIR}/../../src/events/amc/*.c
        ${CMAKE_CURRENT_SOURCE_DIR}/../../src/modules/amc/*.c
        ${CMAKE_CURRENT_SOURCE_DIR}/../../src/modules/amc/lib/*.c
        ${CMAKE_CURRENT_SOURCE_DIR}/../../src/events/buzzer/*.c
        ${CMAKE_CURRENT_SOURCE_DIR}/../../src/events/error_handler/*.c
        ${CMAKE_CURRENT_SOURCE_DIR}/../../src/events/messaging/*.c
        ${CMAKE_CURRENT_SOURCE_DIR}/../../src/events/storage_controller/*.c
        ${CMAKE_CURRENT_SOURCE_DIR}/../../src/events/gnss_controller/*.c
        ${CMAKE_CURRENT_SOURCE_DIR}/../../src/events/electric_pulse/*.c
        ${CMAKE_CURRENT_SOURCE_DIR}/../../src/events/ble/*.c
        ${CMAKE_CURRENT_SOURCE_DIR}/../../src/events/movement_controller/*.c
        ${CMAKE_CURRENT_SOURCE_DIR}/../../src/events/power_manager/*.c
)
target_sources(app PRIVATE ${app_sources})
target_include_directories(app PRIVATE ${APP_SOURCE})

zephyr_library_include_directories(
  ${CMAKE_CURRENT_SOURCE_DIR}/mock
  ${CMAKE_CURRENT_SOURCE_DIR}/../../include/
  ${CMAKE_CURRENT_SOURCE_DIR}/../../src/lib/trigonometry/
  ${CMAKE_CURRENT_SOURCE_DIR}/../../src/lib/fifo/
  ${CMAKE_CURRENT_SOURCE_DIR}/../../src/modules/amc/
  ${CMAKE_CURRENT_SOURCE_DIR}/../../src/modules/amc/lib/include
  ${CMAKE_CURRENT_SOURCE_DIR}/../../src/events/amc
  ${CMAKE_CURRENT_SOURCE_DIR}/../../src/events/buzzer
  ${CMAKE_CURRENT_SOURCE_DIR}/../../src/events/error_handler
  ${CMAKE_CURRENT_SOURCE_DIR}/../../src/events/storage_controller
  ${CMAKE_CURRENT_SOURCE_DIR}/../../src/events/gnss_controller
  ${CMAKE_CURRENT_SOURCE_DIR}/../../src/events/messaging
  ${CMAKE_CURRENT_SOURCE_DIR}/../../src/modules/storage_controller/include
  ${CMAKE_CURRENT_SOURCE_DIR}/../../src/modules/storage_controller
  ${CMAKE_CURRENT_SOURCE_DIR}/../../src/drivers/gnss/zephyr
  ${CMAKE_CURRENT_SOURCE_DIR}/../../src/events/ble
  ${CMAKE_CURRENT_SOURCE_DIR}/../../src/events/electric_pulse
  ${CMAKE_CURRENT_SOURCE_DIR}/../../src/events/movement_controller
  ${CMAKE_CURRENT_SOURCE_DIR}/../../src/events/power_manager
  ${CMAKE_CURRENT_SOURCE_DIR}/../../src/modules/movement_controller
)

add_dependencies(app collar_protocol_headers)
```

## Kconfig
```
menu "APPLICATION_CODE"
	menu "AMC"
    	rsource "./../../src/modules/amc/Kconfig"
	endmenu # AMC

	menu "ERROR_HANDLER"
    	rsource "./../../src/modules/error_handler/Kconfig"
	endmenu # ERROR_HANDLER

	menu "MOVE_CONTROLLER"
    	rsource "./../../src/modules/movement_controller/Kconfig"
	endmenu # MOVE_CONTROLLER
endmenu # APPLICATION CODE

menu "Zephyr Kernel"
source "Kconfig.zephyr"
endmenu
```

## prj.conf
```kconfig
CONFIG_ZTEST=y
CONFIG_ZTEST_MOCKING=y
CONFIG_DEBUG=y

# Configuration required by Event Manager
CONFIG_EVENT_MANAGER=y
CONFIG_LINKER_ORPHAN_SECTION_PLACE=y
CONFIG_SYSTEM_WORKQUEUE_STACK_SIZE=16384
CONFIG_HEAP_MEM_POOL_SIZE=16384
CONFIG_REBOOT=y

CONFIG_COLLAR_PROTOCOL=y

CONFIG_ZONE_CAUTION_DIST=-110
CONFIG_ZONE_CAUTION_HYST=10
CONFIG_ZONE_PREWARN_DIST=-60
CONFIG_ZONE_PREWARN_HYST=10
CONFIG_ZONE_WARN_DIST=0
CONFIG_ZONE_WARN_HYST=0
CONFIG_AMC_LOG_LEVEL_DBG=y
CONFIG_AMC_LIB_LOG_LEVEL_DBG=y
CONFIG_EVENT_MANAGER_MAX_EVENT_CNT=70
```

## src/amc_collar_fence_test.c
```c
#include "amc_test_common.h"
#include "amc_gnss.h"
#include <ztest.h>
#include "amc_states_cache.h"
#include "embedded.pb.h"
#include "gnss_controller_events.h"
#include "messaging_module_events.h"
#include "amc_cache.h"
#include "pwr_event.h"

K_SEM_DEFINE(fence_status_sem, 0, 1);
static FenceStatus current_fence_status = FenceStatus_FenceStatus_UNKNOWN;

K_SEM_DEFINE(collar_status_sem, 0, 1);
static CollarStatus current_collar_status = CollarStatus_CollarStatus_UNKNOWN;

K_SEM_DEFINE(collar_mode_sem, 0, 1);
static Mode current_collar_mode = Mode_Mode_UNKNOWN;

void test_fence_status(void)
{
	/* Check if we have valid pasture cached. */
	zassert_true(fnc_valid_def(), "");

	/* Init GNSS cache etc.. */
	amc_gnss_init();

	FenceStatus expected_status;

	ztest_returns_value(stg_config_u8_write, 0);
	force_fence_status(FenceStatus_NotStarted);
	zassert_equal(get_fence_status(), FenceStatus_NotStarted, "");

	/* Check force fence status functionality */
	for (int fence_status_idx = 0; fence_status_idx < 9; fence_status_idx++) {
		if ((fence_status_idx == FenceStatus_FenceStatus_UNKNOWN) ||
		    (fence_status_idx == FenceStatus_NotStarted) ||
		    (fence_status_idx == FenceStatus_FenceStatus_Invalid) ||
		    (fence_status_idx == FenceStatus_TurnedOffByBLE)) {
			if (fence_status_idx == FenceStatus_NotStarted) {
				/* Test storage write failure */
				ztest_returns_value(stg_config_u8_write, -1);
				zassert_not_equal(force_fence_status(FenceStatus_NotStarted), 0,
						  "");
			}
			ztest_returns_value(stg_config_u8_write, 0);
			zassert_equal(force_fence_status(fence_status_idx), 0,
				      "Force fence status failed");

			k_sem_reset(&fence_status_sem);
			zassert_equal(k_sem_take(&fence_status_sem, K_SECONDS(30)), 0,
				      "Didn't receive status change");
			zassert_equal(current_fence_status, fence_status_idx,
				      "Force failed to set correct status");
		} else {
			/* Only force "UNKNOWN", "NotStarted" and "Invalid" */
			zassert_not_equal(force_fence_status(fence_status_idx), 0,
					  "Forced invalid fence status");
		}
	}
	/* Set fence status to NotStarted for continued testing */
	if (get_fence_status() != FenceStatus_NotStarted) {
		ztest_returns_value(stg_config_u8_write, 0);
		zassert_equal(force_fence_status(FenceStatus_NotStarted), 0, "");
	}

	/* NotStarted -> Normal */
	simulate_accepted_fix();
	zassert_equal(zone_set(PSM_ZONE), 0, "");

	ztest_returns_value(stg_config_u8_write, 0);

	expected_status = FenceStatus_FenceStatus_Normal;
	zassert_equal(calc_fence_status(0, BEACON_STATUS_NOT_FOUND), expected_status, "");

	k_sem_reset(&fence_status_sem);
	zassert_equal(k_sem_take(&fence_status_sem, K_SECONDS(30)), 0, "");
	zassert_equal(current_fence_status, expected_status, "");

	/* Normal -> Escaped */
	/* To get to escaped, we need to have zapped 3 times. Reset the zaps
	 * and zap 3 times.
	 */
	reset_zap_pain_cnt();

	for (int i = 0; i < 3; i++) {
		/* Mock total zaps and daily zaps. */
		ztest_returns_value(stg_config_u16_write, 0);
		ztest_returns_value(stg_config_u16_write, 0);

		increment_zap_count();
	}

	simulate_accepted_fix();

	/* Zone is irrelevant, the check is against how many zaps we've given
	 * regardless of position. 
	 */
	zassert_equal(zone_set(NO_ZONE), 0, "");

	ztest_returns_value(stg_config_u8_write, 0);

	expected_status = FenceStatus_Escaped;
	zassert_equal(calc_fence_status(0, BEACON_STATUS_NOT_FOUND), expected_status, "");
	k_sem_reset(&fence_status_sem);
	zassert_equal(k_sem_take(&fence_status_sem, K_SECONDS(30)), 0, "");
	zassert_equal(current_fence_status, expected_status, "");

	/* Escaped -> Normal */
	simulate_accepted_fix();
	zassert_equal(zone_set(CAUTION_ZONE), 0, "");

	ztest_returns_value(stg_config_u8_write, 0);

	expected_status = FenceStatus_FenceStatus_Normal;
	zassert_equal(calc_fence_status(0, BEACON_STATUS_NOT_FOUND), expected_status, "");
	zassert_equal(k_sem_take(&fence_status_sem, K_SECONDS(30)), 0, "");
	zassert_equal(current_fence_status, expected_status, "");

	/* Normal -> Beacon Contact normal */
	simulate_accepted_fix();
	zassert_equal(zone_set(CAUTION_ZONE), 0, "");

	ztest_returns_value(stg_config_u8_write, 0);

	expected_status = FenceStatus_BeaconContactNormal;
	zassert_equal(calc_fence_status(0, BEACON_STATUS_REGION_NEAR), expected_status, "");
	zassert_equal(k_sem_take(&fence_status_sem, K_SECONDS(30)), 0, "");
	zassert_equal(current_fence_status, expected_status, "");

	/* Beacon contact normal ->  Normal*/
	ztest_returns_value(stg_config_u8_write, 0);

	expected_status = FenceStatus_FenceStatus_Normal;
	zassert_equal(calc_fence_status(0, BEACON_STATUS_NOT_FOUND), expected_status, "");
	zassert_equal(k_sem_take(&fence_status_sem, K_SECONDS(30)), 0, "");
	zassert_equal(current_fence_status, expected_status, "");

	/* Normal -> Maybe out of fence */
	ztest_returns_value(stg_config_u8_write, 0);

	/* We get to maybe out of fence if the delta is 900 or more.
	 * Set timestamp here, then wait 905 seconds. */
	uint32_t maybe_timestamp = k_uptime_get_32();

	k_sleep(K_SECONDS(905));

	expected_status = FenceStatus_MaybeOutOfFence;
	zassert_equal(calc_fence_status(maybe_timestamp, BEACON_STATUS_NOT_FOUND), expected_status,
		      "");
	zassert_equal(k_sem_take(&fence_status_sem, K_SECONDS(30)), 0, "");
	zassert_equal(current_fence_status, expected_status, "");

	/* Maybe out of fence -> Beacon Contact */
	ztest_returns_value(stg_config_u8_write, 0);

	expected_status = FenceStatus_BeaconContact;

	/* Use same timestamp here, we know it's still as maybe out of fence. */
	zassert_equal(calc_fence_status(maybe_timestamp, BEACON_STATUS_REGION_NEAR),
		      expected_status, "");
	zassert_equal(k_sem_take(&fence_status_sem, K_SECONDS(30)), 0, "");
	zassert_equal(current_fence_status, expected_status, "");

	/* Beacon Contact -> NotStarted */
	ztest_returns_value(stg_config_u8_write, 0);

	expected_status = FenceStatus_NotStarted;
	zassert_equal(calc_fence_status(0, BEACON_STATUS_REGION_FAR), expected_status, "");
	zassert_equal(k_sem_take(&fence_status_sem, K_SECONDS(30)), 0, "");
	zassert_equal(current_fence_status, expected_status, "");

	/* NotStarted -> Beacon Contact */
	ztest_returns_value(stg_config_u8_write, 0);

	expected_status = FenceStatus_BeaconContact;
	zassert_equal(calc_fence_status(0, BEACON_STATUS_REGION_NEAR), expected_status, "");
	zassert_equal(k_sem_take(&fence_status_sem, K_SECONDS(30)), 0, "");
	zassert_equal(current_fence_status, expected_status, "");

	/* Beacon Contact -> Unknown */
	/* We only enter this state if pasture is invalid. */
	pasture_t empty_pasture;
	memset(&empty_pasture, 0, sizeof(pasture_t));
	zassert_equal(set_pasture_cache((uint8_t *)&empty_pasture, sizeof(empty_pasture)), 0, "");

	ztest_returns_value(stg_config_u8_write, 0);

	expected_status = FenceStatus_FenceStatus_UNKNOWN;
	zassert_equal(calc_fence_status(0, BEACON_STATUS_REGION_FAR), expected_status, "");
	zassert_equal(k_sem_take(&fence_status_sem, K_SECONDS(30)), 0, "");
	zassert_equal(current_fence_status, expected_status, "");

	/* Unknown -> Beacon Contact */
	/* We'll never reach NotStarted from unknown due to our
	 * pasture being invalid.
	 */
	ztest_returns_value(stg_config_u8_write, 0);

	expected_status = FenceStatus_BeaconContact;
	zassert_equal(calc_fence_status(0, BEACON_STATUS_REGION_NEAR), expected_status, "");
	zassert_equal(k_sem_take(&fence_status_sem, K_SECONDS(30)), 0, "");
	zassert_equal(current_fence_status, expected_status, "");
}

void test_collar_mode(void)
{
	/* We expect unknown when we boot. */
	Mode expected_mode = Mode_Mode_UNKNOWN;
	zassert_equal(k_sem_take(&collar_mode_sem, K_SECONDS(30)), 0, "");
	zassert_equal(current_collar_mode, expected_mode, "");

	/* Unknown -> Teach. */
	ztest_returns_value(stg_config_u8_write, 0);
	expected_mode = Mode_Teach;

	zassert_equal(calc_mode(), expected_mode, "");
	zassert_equal(k_sem_take(&collar_mode_sem, K_SECONDS(30)), 0, "");
	zassert_equal(current_collar_mode, expected_mode, "");

	/* Teach -> Fence. */
	ztest_returns_value(stg_config_u8_write, 0);
	/* To reach this, we need to reach the zap and warn count tresholds. 
	 * I.e ((teach_warn_cnt - teach_zap_cnt) >=
			    _TEACHMODE_WARN_CNT_LOWLIM)
	 * needs to be fulfilled. In other words, the animal must have
	 * managed to get warned 20 times without getting a zap.
	 */
	for (int i = 0; i < _TEACHMODE_WARN_CNT_LOWLIM + 1; i++) {
		/* Mock the storage calls. */
		ztest_returns_value(stg_config_u32_write, 0);
		increment_warn_count();
	}
	ztest_returns_value(stg_config_u8_write, 0);
	expected_mode = Mode_Fence;

	zassert_equal(calc_mode(), expected_mode, "");
	zassert_equal(k_sem_take(&collar_mode_sem, K_SECONDS(30)), 0, "");
	zassert_equal(current_collar_mode, expected_mode, "");
}

void test_collar_status(void)
{
	ztest_returns_value(stg_config_u8_write, 0);
	/* We expect unknown when we boot. */
	CollarStatus expected_status = CollarStatus_CollarStatus_UNKNOWN;
	zassert_equal(k_sem_take(&collar_status_sem, K_SECONDS(30)), 0, "");
	zassert_equal(current_collar_status, expected_status, "");

	/* Unknown -> normal. */
	//ztest_returns_value(stg_config_u8_write, 0);
	update_movement_state(STATE_NORMAL);

	expected_status = CollarStatus_CollarStatus_Normal;
	zassert_equal(calc_collar_status(), expected_status, "");
	zassert_equal(k_sem_take(&collar_status_sem, K_SECONDS(30)), 0, "");
	zassert_equal(current_collar_status, expected_status, "");

	/* Normal -> sleep. */
	ztest_returns_value(stg_config_u8_write, 0);
	update_movement_state(STATE_SLEEP);

	expected_status = CollarStatus_Sleep;
	zassert_equal(calc_collar_status(), expected_status, "");
	zassert_equal(k_sem_take(&collar_status_sem, K_SECONDS(30)), 0, "");
	zassert_equal(current_collar_status, expected_status, "");

	/* Sleep -> OffAnimal. */
	ztest_returns_value(stg_config_u8_write, 0);
	update_movement_state(STATE_INACTIVE);

	expected_status = CollarStatus_OffAnimal;
	zassert_equal(calc_collar_status(), expected_status, "");
	zassert_equal(k_sem_take(&collar_status_sem, K_SECONDS(30)), 0, "");
	zassert_equal(current_collar_status, expected_status, "");

	/* OffAnimal -> normal. */
	ztest_returns_value(stg_config_u8_write, 0);
	update_movement_state(STATE_NORMAL);

	expected_status = CollarStatus_CollarStatus_Normal;
	zassert_equal(calc_collar_status(), expected_status, "");
	zassert_equal(k_sem_take(&collar_status_sem, K_SECONDS(30)), 0, "");
	zassert_equal(current_collar_status, expected_status, "");

	/* Normal -> STATE_INACTIVE (Normal) (do nothing). */
	update_movement_state(STATE_INACTIVE);

	expected_status = CollarStatus_CollarStatus_Normal;
	zassert_equal(calc_collar_status(), expected_status, "");
	/* No event is triggered, since we're in the same state. */

	/* Normal -> Power OFF. */
	ztest_returns_value(stg_config_u8_write, 0);
	update_movement_state(STATE_NORMAL);
	update_power_state(PWR_CRITICAL);

	expected_status = CollarStatus_PowerOff;
	zassert_equal(calc_collar_status(), expected_status, "");
	zassert_equal(k_sem_take(&collar_status_sem, K_SECONDS(30)), 0, "");
	zassert_equal(current_collar_status, expected_status, "");

	/* Power OFF -> Sleep. */
	ztest_returns_value(stg_config_u8_write, 0);
	update_movement_state(STATE_SLEEP);
	update_power_state(PWR_LOW);

	expected_status = CollarStatus_Sleep;
	zassert_equal(calc_collar_status(), expected_status, "");
	zassert_equal(k_sem_take(&collar_status_sem, K_SECONDS(30)), 0, "");
	zassert_equal(current_collar_status, expected_status, "");
}

static bool event_handler(const struct event_header *eh)
{
	if (is_update_collar_status(eh)) {
		struct update_collar_status *ev = cast_update_collar_status(eh);
		current_collar_status = ev->collar_status;
		k_sem_give(&collar_status_sem);
		return false;
	}
	if (is_update_fence_status(eh)) {
		struct update_fence_status *ev = cast_update_fence_status(eh);
		current_fence_status = ev->fence_status;
		k_sem_give(&fence_status_sem);
		return false;
	}
	if (is_update_collar_mode(eh)) {
		struct update_collar_mode *ev = cast_update_collar_mode(eh);
		current_collar_mode = ev->collar_mode;
		k_sem_give(&collar_mode_sem);
		return false;
	}
	return false;
}

EVENT_LISTENER(test_collar_fence_handler, event_handler);
EVENT_SUBSCRIBE(test_collar_fence_handler, update_collar_status);
EVENT_SUBSCRIBE(test_collar_fence_handler, update_fence_status);
EVENT_SUBSCRIBE(test_collar_fence_handler, update_collar_mode);
```

## src/amc_dist_test.c
```c
#include "amc_test_common.h"
#include "pasture_structure.h"
#include "amc_cache.h"
#include "amc_dist.h"
#include "embedded.pb.h"
#include <ztest.h>
#include <math.h>
#include <stdlib.h>

int16_t g_i16_warn_start_way_p[2];
int16_t g_i16_heading;

const uint8_t VERTEX_RIGHT = 1;
const uint8_t VERTEX_TOP = 2;
const uint8_t VERTEX_LEFT = 3;
const uint8_t VERTEX_BOTTOM = 4;

void test_fnc_calc_dist_quadratic(void)
{
	/* Pasture. */
	pasture_t pasture = {
		.m.ul_total_fences = 1,
	};

	/* Fences. */
	pasture.fences[0].m.e_fence_type = FenceDefinitionMessage_FenceType_Normal;
	pasture.fences[0].m.us_id = 0;
	pasture.fences[0].m.fence_no = 0;

	/* Coordinates. */
	fence_coordinate_t points1[] = {
		{ .s_x_dm = 10, .s_y_dm = -10 }, { .s_x_dm = 10, .s_y_dm = 10 },
		{ .s_x_dm = -10, .s_y_dm = 10 }, { .s_x_dm = -10, .s_y_dm = -10 },
		{ .s_x_dm = 10, .s_y_dm = -10 },
	};
	pasture.fences[0].m.n_points = sizeof(points1) / sizeof(points1[0]);
	memcpy(pasture.fences[0].coordinates, points1, sizeof(points1));
	zassert_false(set_pasture_cache((uint8_t *)&pasture, sizeof(pasture)), "");

	int16_t d;
	uint8_t fence_index;
	uint8_t vertex_index;

	d = fnc_calc_dist(0, 0, &fence_index, &vertex_index);
	zassert_equal(-10, d, "");
	zassert_equal(0, fence_index, "");
	zassert_equal(VERTEX_RIGHT, vertex_index, "");

	d = fnc_calc_dist(10, 10, &fence_index, &vertex_index);
	zassert_equal(0, d, "");
	zassert_equal(VERTEX_RIGHT, vertex_index, "");

	d = fnc_calc_dist(10, 20, &fence_index, &vertex_index);
	zassert_equal(10, d, "");
	zassert_equal(VERTEX_RIGHT, vertex_index, "");

	d = fnc_calc_dist(10, 30, &fence_index, &vertex_index);
	zassert_equal(20, d, "");
	zassert_equal(VERTEX_RIGHT, vertex_index, "");

	d = fnc_calc_dist(-5, -3, &fence_index, &vertex_index);
	zassert_equal(-5, d, "");
	zassert_equal(VERTEX_LEFT, vertex_index, "");

	d = fnc_calc_dist(-5, 3, &fence_index, &vertex_index);
	zassert_equal(-5, d, "");
	zassert_equal(VERTEX_LEFT, vertex_index, "");

	d = fnc_calc_dist(5, -3, &fence_index, &vertex_index);
	zassert_equal(-5, d, "");
	zassert_equal(VERTEX_RIGHT, vertex_index, "");

	d = fnc_calc_dist(5, 3, &fence_index, &vertex_index);
	zassert_equal(-5, d, "");
	zassert_equal(VERTEX_RIGHT, vertex_index, "");

	d = fnc_calc_dist(15, 15, &fence_index, &vertex_index);
	zassert_equal((int16_t)sqrt(5 * 5 + 5 * 5), d, "");

	d = fnc_calc_dist(-15, -15, &fence_index, &vertex_index);
	zassert_equal((int16_t)sqrt(5 * 5 + 5 * 5), d, "");
}

void test_fnc_calc_dist_quadratic_max(void)
{
	/* Pasture. */
	pasture_t pasture = {
		.m.ul_total_fences = 1,
	};

	/* Fences. */
	pasture.fences[0].m.e_fence_type = FenceDefinitionMessage_FenceType_Normal;
	pasture.fences[0].m.us_id = 0;
	pasture.fences[0].m.fence_no = 0;

	/* Coordinates. */
	fence_coordinate_t points1[] = {
		{ .s_x_dm = 10, .s_y_dm = -10 },  { .s_x_dm = 10, .s_y_dm = -9 },
		{ .s_x_dm = 10, .s_y_dm = -8 },	  { .s_x_dm = 10, .s_y_dm = -7 },
		{ .s_x_dm = 10, .s_y_dm = -6 },	  { .s_x_dm = 10, .s_y_dm = -5 },
		{ .s_x_dm = 10, .s_y_dm = -4 },	  { .s_x_dm = 10, .s_y_dm = -3 },
		{ .s_x_dm = 10, .s_y_dm = -2 },	  { .s_x_dm = 10, .s_y_dm = -1 },
		{ .s_x_dm = 10, .s_y_dm = 1 },	  { .s_x_dm = 10, .s_y_dm = 2 },
		{ .s_x_dm = 10, .s_y_dm = 3 },	  { .s_x_dm = 10, .s_y_dm = 4 },
		{ .s_x_dm = 10, .s_y_dm = 5 },	  { .s_x_dm = 10, .s_y_dm = 6 },
		{ .s_x_dm = 10, .s_y_dm = 7 },	  { .s_x_dm = 10, .s_y_dm = 8 },
		{ .s_x_dm = 10, .s_y_dm = 9 },	  { .s_x_dm = 10, .s_y_dm = 10 },
		{ .s_x_dm = 9, .s_y_dm = 10 },	  { .s_x_dm = 8, .s_y_dm = 10 },
		{ .s_x_dm = 7, .s_y_dm = 10 },	  { .s_x_dm = 6, .s_y_dm = 10 },
		{ .s_x_dm = 5, .s_y_dm = 10 },	  { .s_x_dm = 4, .s_y_dm = 10 },
		{ .s_x_dm = 3, .s_y_dm = 10 },	  { .s_x_dm = 2, .s_y_dm = 10 },
		{ .s_x_dm = 1, .s_y_dm = 10 },	  { .s_x_dm = 0, .s_y_dm = 10 },
		{ .s_x_dm = -1, .s_y_dm = 10 },	  { .s_x_dm = -2, .s_y_dm = 10 },
		{ .s_x_dm = -3, .s_y_dm = 10 },	  { .s_x_dm = -4, .s_y_dm = 10 },
		{ .s_x_dm = -5, .s_y_dm = 10 },	  { .s_x_dm = -6, .s_y_dm = 10 },
		{ .s_x_dm = -7, .s_y_dm = 10 },	  { .s_x_dm = -10, .s_y_dm = 10 },
		{ .s_x_dm = -10, .s_y_dm = -10 }, { .s_x_dm = 10, .s_y_dm = -10 }
	};

	pasture.fences[0].m.n_points = sizeof(points1) / sizeof(points1[0]);
	memcpy(pasture.fences[0].coordinates, points1, sizeof(points1));
	zassert_false(set_pasture_cache((uint8_t *)&pasture, sizeof(pasture)), "");

	int16_t d;
	uint8_t fence_index;
	uint8_t vertex_index;

	d = fnc_calc_dist(0, 0, &fence_index, &vertex_index);
	zassert_equal(-10, d, "");

	d = fnc_calc_dist(10, 10, &fence_index, &vertex_index);
	zassert_equal(0, d, "");

	d = fnc_calc_dist(10, 20, &fence_index, &vertex_index);
	zassert_equal(10, d, "");

	d = fnc_calc_dist(10, 30, &fence_index, &vertex_index);
	zassert_equal(20, d, "");

	d = fnc_calc_dist(-5, -5, &fence_index, &vertex_index);
	zassert_equal(-5, d, "");

	d = fnc_calc_dist(-5, 5, &fence_index, &vertex_index);
	zassert_equal(-5, d, "");

	d = fnc_calc_dist(5, -5, &fence_index, &vertex_index);
	zassert_equal(-5, d, "");

	d = fnc_calc_dist(5, 5, &fence_index, &vertex_index);
	zassert_equal(-5, d, "");
}

void test_fnc_calc_dist_rect(void)
{
	/* Pasture. */
	pasture_t pasture = {
		.m.ul_total_fences = 1,
	};

	/* Fences. */
	pasture.fences[0].m.e_fence_type = FenceDefinitionMessage_FenceType_Normal;
	pasture.fences[0].m.us_id = 0;
	pasture.fences[0].m.fence_no = 0;

	/* Coordinates. */
	fence_coordinate_t points1[] = {
		{ .s_x_dm = 100, .s_y_dm = -10 }, { .s_x_dm = 100, .s_y_dm = 10 },
		{ .s_x_dm = -100, .s_y_dm = 10 }, { .s_x_dm = -100, .s_y_dm = -10 },
		{ .s_x_dm = 100, .s_y_dm = -10 },

	};
	pasture.fences[0].m.n_points = sizeof(points1) / sizeof(points1[0]);
	memcpy(pasture.fences[0].coordinates, points1, sizeof(points1));
	zassert_false(set_pasture_cache((uint8_t *)&pasture, sizeof(pasture)), "");

	int16_t d;
	uint8_t fence_index;
	uint8_t vertex_index;

	d = fnc_calc_dist(50, 0, &fence_index, &vertex_index);
	zassert_equal(-10, d, "");

	d = fnc_calc_dist(100, 10, &fence_index, &vertex_index);
	zassert_equal(0, d, "");

	d = fnc_calc_dist(50, 20, &fence_index, &vertex_index);
	zassert_equal(10, d, "");

	d = fnc_calc_dist(50, 30, &fence_index, &vertex_index);
	zassert_equal(20, d, "");

	d = fnc_calc_dist(-50, -5, &fence_index, &vertex_index);
	zassert_equal(-5, d, "");

	d = fnc_calc_dist(-50, 5, &fence_index, &vertex_index);
	zassert_equal(-5, d, "");

	d = fnc_calc_dist(50, -5, &fence_index, &vertex_index);
	zassert_equal(-5, d, "");

	d = fnc_calc_dist(50, 5, &fence_index, &vertex_index);
	zassert_equal(-5, d, "");
}

void test_fnc_calc_dist_2_fences_hole(void)
{
	/* Pasture. */
	pasture_t pasture = {
		.m.ul_total_fences = 2,
	};

	/* Fences. */
	pasture.fences[0].m.e_fence_type = FenceDefinitionMessage_FenceType_Normal;
	pasture.fences[0].m.us_id = 0;
	pasture.fences[0].m.fence_no = 0;

	pasture.fences[1].m.e_fence_type = FenceDefinitionMessage_FenceType_Inverted;
	pasture.fences[1].m.us_id = 0;
	pasture.fences[1].m.fence_no = 1;

	/* Coordinates. */
	fence_coordinate_t points1[] = {
		{ .s_x_dm = 20, .s_y_dm = -20 }, { .s_x_dm = 20, .s_y_dm = 20 },
		{ .s_x_dm = -20, .s_y_dm = 20 }, { .s_x_dm = -20, .s_y_dm = -20 },
		{ .s_x_dm = 20, .s_y_dm = -20 },
	};
	pasture.fences[0].m.n_points = sizeof(points1) / sizeof(points1[0]);
	memcpy(pasture.fences[0].coordinates, points1, sizeof(points1));

	fence_coordinate_t points2[] = {
		{ .s_x_dm = 10, .s_y_dm = -10 }, { .s_x_dm = 10, .s_y_dm = 10 },
		{ .s_x_dm = -10, .s_y_dm = 10 }, { .s_x_dm = -10, .s_y_dm = -10 },
		{ .s_x_dm = 10, .s_y_dm = -10 },
	};
	pasture.fences[1].m.n_points = sizeof(points2) / sizeof(points2[0]);
	memcpy(pasture.fences[1].coordinates, points2, sizeof(points2));

	zassert_false(set_pasture_cache((uint8_t *)&pasture, sizeof(pasture)), "");

	int16_t d;
	uint8_t fence_index;
	uint8_t vertex_index;

	d = fnc_calc_dist(0, 0, &fence_index, &vertex_index);
	zassert_equal(10, d, "");
	zassert_equal(1, fence_index, "");
	zassert_equal(VERTEX_RIGHT, vertex_index, "");

	d = fnc_calc_dist(0, 10, &fence_index, &vertex_index);
	zassert_equal(0, d, "");
	zassert_equal(1, fence_index, "");
	zassert_equal(VERTEX_TOP, vertex_index, "");

	d = fnc_calc_dist(0, 14, &fence_index, &vertex_index);
	zassert_equal(-4, d, "");
	zassert_equal(1, fence_index, "");
	zassert_equal(VERTEX_TOP, vertex_index, "");

	d = fnc_calc_dist(0, 16, &fence_index, &vertex_index);
	zassert_equal(-4, d, "");
	zassert_equal(0, fence_index, "");
	zassert_equal(VERTEX_TOP, vertex_index, "");

	d = fnc_calc_dist(0, 20, &fence_index, &vertex_index);
	zassert_equal(0, d, "");
	zassert_equal(0, fence_index, "");
	zassert_equal(VERTEX_TOP, vertex_index, "");

	d = fnc_calc_dist(0, 25, &fence_index, &vertex_index);
	zassert_equal(5, d, "");
	zassert_equal(0, fence_index, "");
	zassert_equal(VERTEX_TOP, vertex_index, "");

	d = fnc_calc_dist(0, 105, &fence_index, &vertex_index);
	zassert_equal(85, d, "");
	zassert_equal(0, fence_index, "");
	zassert_equal(VERTEX_TOP, vertex_index, "");

	d = fnc_calc_dist(0, 1020, &fence_index, &vertex_index);
	zassert_equal(1000, d, "");
	d = fnc_calc_dist(0, INT16_MAX - 100, &fence_index, &vertex_index);
	zassert_equal(INT16_MAX - 100 - 20, d, "");
}

void test_fnc_calc_dist_2_fences_max_size(void)
{
	const int16_t MAX_FENCE = 32500;

	/* Pasture. */
	pasture_t pasture = {
		.m.ul_total_fences = 1,
	};

	/* Fences. */
	pasture.fences[0].m.e_fence_type = FenceDefinitionMessage_FenceType_Normal;
	pasture.fences[0].m.us_id = 0;
	pasture.fences[0].m.fence_no = 0;

	/* Coordinates. */
	fence_coordinate_t points1[] = {
		{ .s_x_dm = -MAX_FENCE, .s_y_dm = -MAX_FENCE },
		{ .s_x_dm = MAX_FENCE, .s_y_dm = -MAX_FENCE },
		{ .s_x_dm = MAX_FENCE, .s_y_dm = MAX_FENCE },
		{ .s_x_dm = -MAX_FENCE, .s_y_dm = MAX_FENCE },
		{ .s_x_dm = -MAX_FENCE, .s_y_dm = -MAX_FENCE },

	};

	pasture.fences[0].m.n_points = sizeof(points1) / sizeof(points1[0]);
	memcpy(pasture.fences[0].coordinates, points1, sizeof(points1));
	zassert_false(set_pasture_cache((uint8_t *)&pasture, sizeof(pasture)), "");

	int16_t d;
	uint8_t fence_index;
	uint8_t vertex_index;

	d = fnc_calc_dist(0, -MAX_FENCE, &fence_index, &vertex_index);
	zassert_equal(0, d, "");

	d = fnc_calc_dist(0, 0, &fence_index, &vertex_index);
	zassert_equal(-MAX_FENCE, d, "");

	d = fnc_calc_dist(MAX_FENCE, MAX_FENCE, &fence_index, &vertex_index);
	zassert_equal(-0, d, "");

	d = fnc_calc_dist(MAX_FENCE, -MAX_FENCE, &fence_index, &vertex_index);
	zassert_equal(-0, d, "");

	d = fnc_calc_dist(-MAX_FENCE, MAX_FENCE, &fence_index, &vertex_index);
	zassert_equal(-0, d, "");

	d = fnc_calc_dist(-MAX_FENCE, -MAX_FENCE, &fence_index, &vertex_index);
	zassert_equal(-0, d, "");

	/* INT MAX/MIN. */
	d = fnc_calc_dist(0, INT16_MAX, &fence_index, &vertex_index);
	zassert_equal((int32_t)INT16_MAX - MAX_FENCE, d, "");

	d = fnc_calc_dist(0, INT16_MIN, &fence_index, &vertex_index);
	zassert_equal(abs(INT16_MIN + MAX_FENCE), d, "");

	d = fnc_calc_dist(INT16_MAX, INT16_MAX, &fence_index, &vertex_index);
	zassert_equal(round(sqrt(2 * pow(INT16_MAX - MAX_FENCE, 2))), d, "");

	d = fnc_calc_dist(INT16_MIN, INT16_MIN, &fence_index, &vertex_index);
	zassert_equal(round(sqrt(2 * pow(INT16_MIN + MAX_FENCE, 2))), d, "");
}

void test_fnc_calc_dist_2_fences_hole2(void)
{
	/* Pasture. */
	pasture_t pasture = {
		.m.ul_total_fences = 2,
	};

	/* Fences. */
	pasture.fences[0].m.e_fence_type = FenceDefinitionMessage_FenceType_Normal;
	pasture.fences[0].m.us_id = 0;
	pasture.fences[0].m.fence_no = 0;

	pasture.fences[1].m.e_fence_type = FenceDefinitionMessage_FenceType_Inverted;
	pasture.fences[1].m.us_id = 0;
	pasture.fences[1].m.fence_no = 1;

	/* Coordinates. */
	fence_coordinate_t points1[] = {
		{ .s_x_dm = 100, .s_y_dm = -50 },  { .s_x_dm = 100, .s_y_dm = 100 },
		{ .s_x_dm = -100, .s_y_dm = 100 }, { .s_x_dm = -100, .s_y_dm = -50 },
		{ .s_x_dm = 100, .s_y_dm = -50 },
	};

	pasture.fences[0].m.n_points = sizeof(points1) / sizeof(points1[0]);
	memcpy(pasture.fences[0].coordinates, points1, sizeof(points1));

	fence_coordinate_t points2[] = { { .s_x_dm = 90, .s_y_dm = 80 },
					 { .s_x_dm = 90, .s_y_dm = 90 },
					 { .s_x_dm = -90, .s_y_dm = 90 },
					 { .s_x_dm = -90, .s_y_dm = 80 },
					 { .s_x_dm = 90, .s_y_dm = 80 } };

	pasture.fences[1].m.n_points = sizeof(points2) / sizeof(points2[0]);
	memcpy(pasture.fences[1].coordinates, points2, sizeof(points2));

	zassert_false(set_pasture_cache((uint8_t *)&pasture, sizeof(pasture)), "");

	uint8_t fence_index;
	uint8_t vertex_index;
	int16_t d;

	d = fnc_calc_dist(0, 0, &fence_index, &vertex_index);
	zassert_equal(-50, d, "");
	zassert_equal(0, fence_index, "");
	zassert_equal(VERTEX_BOTTOM, vertex_index, "");

	/* Up. */
	d = fnc_calc_dist(0, 10, &fence_index, &vertex_index);
	zassert_equal(-60, d, "");
	zassert_equal(0, fence_index, "");
	zassert_equal(VERTEX_BOTTOM, vertex_index, "");

	d = fnc_calc_dist(0, 20, &fence_index, &vertex_index);
	zassert_equal(-60, d, "");
	zassert_equal(1, fence_index, "");
	zassert_equal(VERTEX_BOTTOM, vertex_index, "");

	d = fnc_calc_dist(0, 30, &fence_index, &vertex_index);
	zassert_equal(-50, d, "");
	zassert_equal(1, fence_index, "");
	zassert_equal(VERTEX_BOTTOM, vertex_index, "");

	d = fnc_calc_dist(0, 70, &fence_index, &vertex_index);
	zassert_equal(-10, d, "");
	zassert_equal(1, fence_index, "");
	zassert_equal(VERTEX_BOTTOM, vertex_index, "");

	d = fnc_calc_dist(0, 80, &fence_index, &vertex_index);
	zassert_equal(0, d, "");
	zassert_equal(1, fence_index, "");
	zassert_equal(VERTEX_BOTTOM, vertex_index, "");

	d = fnc_calc_dist(0, 85, &fence_index, &vertex_index);
	zassert_equal(5, d, "");
	zassert_equal(1, fence_index, "");
	zassert_equal(VERTEX_TOP, vertex_index, "");

	d = fnc_calc_dist(0, 90, &fence_index, &vertex_index);
	zassert_equal(0, d, "");
	zassert_equal(1, fence_index, "");
	zassert_equal(VERTEX_TOP, vertex_index, "");

	d = fnc_calc_dist(0, 95, &fence_index, &vertex_index);
	zassert_equal(-5, d, "");
	zassert_equal(0, fence_index, "");
	zassert_equal(VERTEX_TOP, vertex_index, "");

	d = fnc_calc_dist(0, 100, &fence_index, &vertex_index);
	zassert_equal(0, d, "");
	zassert_equal(0, fence_index, "");
	zassert_equal(VERTEX_TOP, vertex_index, "");

	d = fnc_calc_dist(0, 105, &fence_index, &vertex_index);
	zassert_equal(5, d, "");
	zassert_equal(0, fence_index, "");
	zassert_equal(VERTEX_TOP, vertex_index, "");

	d = fnc_calc_dist(0, 1000, &fence_index, &vertex_index);
	zassert_equal(900, d, "");

	/* Down. */
	d = fnc_calc_dist(0, -10, &fence_index, &vertex_index);
	zassert_equal(-40, d, "");
	d = fnc_calc_dist(0, -20, &fence_index, &vertex_index);
	zassert_equal(-30, d, "");
	d = fnc_calc_dist(0, -50, &fence_index, &vertex_index);
	zassert_equal(0, d, "");
}
```

## src/amc_gnss_test.c
```c
#include "amc_test_common.h"
#include "amc_gnss.h"
#include <ztest.h>
#include "amc_states_cache.h"
#include "embedded.pb.h"
#include "gnss_controller_events.h"

/* Signals GNSS fix timeout */
static struct k_sem gnss_fix_timeout;

static int gnss_timeout(void)
{
	k_sem_give(&gnss_fix_timeout);

	return 0;
}

static gnss_t gnss_data = { .latest = { .pvt_flags = 1 },
			    .fix_ok = true,
			    .lastfix = { .pvt_flags = 1 },
			    .has_lastfix = true };

void simulate_no_fix(void)
{
	memset(&gnss_data, 0, sizeof(gnss_data));

	/* Send GNSS data, has fix, but not much more */
	zassert_equal(gnss_update(&gnss_data), 0, "Failed updating GNSS fix");
}

void simulate_fix(void)
{
	memset(&gnss_data, 0, sizeof(gnss_data));
	gnss_data.latest.pvt_flags = 1;
	gnss_data.fix_ok = true;
	gnss_data.lastfix.pvt_flags = 1;
	gnss_data.has_lastfix = true;

	/* Send GNSS data, has fix, but not much more */
	zassert_equal(gnss_update(&gnss_data), 0, "Failed updating GNSS fix");
}

void simulate_easy_fix(void)
{
	simulate_fix();
	gnss_data.latest.pvt_flags = 1;
	gnss_data.latest.num_sv = 7;
	gnss_data.latest.h_dop = 80;
	gnss_data.latest.h_acc_dm = 65;
	gnss_data.latest.height = 100;
	gnss_data.latest.lat = 0;
	gnss_data.latest.lon = 0;
	zassert_equal(gnss_update(&gnss_data), 0, "Failed updating GNSS fix");
}

void simulate_accepted_fix(void)
{
	simulate_fix();
	gnss_data.latest.pvt_flags = 1;
	gnss_data.latest.num_sv = 7;
	gnss_data.latest.h_dop = 80;
	gnss_data.latest.h_acc_dm = 25;
	gnss_data.latest.height = 100;
	zassert_equal(gnss_update(&gnss_data), 0, "Failed updating GNSS fix");
}

void simulate_warn_fix(void)
{
	simulate_fix();

	gnss_data.latest.pvt_flags = 1;
	gnss_data.latest.num_sv = 7;
	gnss_data.latest.h_dop = 80;
	gnss_data.latest.h_acc_dm = 25;
	gnss_data.latest.height = 100;
	gnss_data.latest.head_acc = 34000;
	zassert_equal(gnss_update(&gnss_data), 0, "Failed updating GNSS fix");

	int16_t dist_avg_change = 60;
	int16_t dist_change = 0;
	int16_t dist_incr_slope_lim = 0;
	uint8_t dist_inc_count = 0;
	uint8_t dist_incr_count = 0;
	int16_t height_delta = 10;
	int16_t acc_delta = -1;
	int16_t mean_dist = 1;
	uint16_t h_acc_dm = 25;
	zassert_equal(gnss_update_dist_flags(dist_avg_change, dist_change, dist_incr_slope_lim,
					     dist_inc_count, dist_incr_count, height_delta,
					     acc_delta, mean_dist, h_acc_dm),
		      0, "Failed to update GNSS fist flags");
}

static void simulate_stale_fix(void)
{
	simulate_accepted_fix();
	gnss_data.latest.pvt_flags = 0;
	zassert_equal(gnss_update(&gnss_data), 0, "Failed updating GNSS fix");
}

void amc_gnss_init(void)
{
	k_sem_init(&gnss_fix_timeout, 0, 1);
	zassert_equal(gnss_init(gnss_timeout), 0, "Failed initializing AMC GNSS");
}

void test_gnss_fix(void)
{
	amc_gnss_init();

	/* Send GNSS data, has fix, but not much more */
	simulate_fix();

	/* Verify state of fix */
	zassert_true(gnss_has_fix(), "Did not have fix");
	zassert_false(gnss_has_accepted_fix(), "Did have accepted fix");
	zassert_false(gnss_has_easy_fix(), "Did have easy fix");

	/* Wait for timeout */
	zassert_equal(k_sem_take(&gnss_fix_timeout, K_MSEC(2000)), 0,
		      "GNSS fix did not timeout as expected");

	/* But no more timeouts for now */
	zassert_equal(k_sem_take(&gnss_fix_timeout, K_MSEC(30000)), -EAGAIN,
		      "GNSS fix timed out more than once");

	/* Lost fix */
	gnss_data.latest.pvt_flags = 0;
	zassert_equal(gnss_update(&gnss_data), 0, "Failed updating GNSS fix");

	/* Verify state of no fix */
	zassert_false(gnss_has_fix(), "Did have fix");
	zassert_false(gnss_has_accepted_fix(), "Did have accepted fix");
	zassert_false(gnss_has_easy_fix(), "Did have easy fix");

	/* Easy fix */
	simulate_easy_fix();

	/* Verify state of easy fix */
	zassert_true(gnss_has_fix(), "Did not have fix");
	zassert_false(gnss_has_accepted_fix(), "Did have accepted fix");
	zassert_true(gnss_has_easy_fix(), "Did not have easy fix");

	/* Accepted fix */
	simulate_accepted_fix();

	/* Verify state of accepted fix */
	zassert_true(gnss_has_fix(), "Did not have fix");
	zassert_true(gnss_has_accepted_fix(), "Did not have accepted fix");
	zassert_true(gnss_has_easy_fix(), "Did not have easy fix");

	/* Verify reset of easy fix on timeout */
	/* Wait for timeout */
	zassert_equal(k_sem_take(&gnss_fix_timeout, K_MSEC(2000)), 0,
		      "GNSS fix did not timeout as expected");

	/* Verify state of easy fix */
	zassert_true(gnss_has_fix(), "Did not have fix");
	zassert_true(gnss_has_accepted_fix(), "Did not have accepted fix");
	zassert_false(gnss_has_easy_fix(), "Did not have easy fix");

	/* Stale fix */
	simulate_stale_fix();
	zassert_false(gnss_has_fix(), "Unexpected fix");
	zassert_false(gnss_has_accepted_fix(), "Unexpected fix");
}

K_SEM_DEFINE(gnss_mode_sem, 0, 1);
static gnss_mode_t current_gnss_mode = GNSSMODE_INACTIVE;

void test_gnss_mode(void)
{
	/* Inactive mode, set first_time_since_start also due to simulate_easy_fix. 
	 * to not receive GNSSMODE_CAUTION.
	 */
	simulate_easy_fix();

	FenceStatus fs = FenceStatus_FenceStatus_Normal;
	CollarStatus cs = CollarStatus_Sleep;
	Mode mode = Mode_Teach;
	amc_zone_t zone = NO_ZONE;

	set_sensor_modes(mode, fs, cs, zone);
	k_sem_reset(&gnss_mode_sem);
	zassert_equal(k_sem_take(&gnss_mode_sem, K_SECONDS(30)), 0, "");
	zassert_equal(current_gnss_mode, GNSSMODE_INACTIVE, "");

	/* Caution mode. */
	simulate_no_fix();

	fs = FenceStatus_FenceStatus_UNKNOWN;
	cs = CollarStatus_CollarStatus_UNKNOWN;
	mode = Mode_Mode_UNKNOWN;
	zone = NO_ZONE;

	set_sensor_modes(mode, fs, cs, zone);
	zassert_equal(k_sem_take(&gnss_mode_sem, K_SECONDS(30)), 0, "");
	zassert_equal(current_gnss_mode, GNSSMODE_CAUTION, "");

	/* PSM mode 1, PSM zone. */
	simulate_easy_fix();

	fs = FenceStatus_FenceStatus_Normal;
	cs = CollarStatus_CollarStatus_Normal;
	mode = Mode_Teach;
	zone = PSM_ZONE;

	set_sensor_modes(mode, fs, cs, zone);
	zassert_equal(k_sem_take(&gnss_mode_sem, K_SECONDS(30)), 0, "");
	zassert_equal(current_gnss_mode, GNSSMODE_PSM, "");

	/* MAX mode. */
	fs = FenceStatus_FenceStatus_Normal;
	cs = CollarStatus_CollarStatus_Normal;
	mode = Mode_Teach;
	zone = WARN_ZONE;

	set_sensor_modes(mode, fs, cs, zone);
	zassert_equal(k_sem_take(&gnss_mode_sem, K_SECONDS(30)), 0, "");
	zassert_equal(current_gnss_mode, GNSSMODE_MAX, "");

	/* PSM mode 2, escaped. */
	simulate_accepted_fix();

	fs = FenceStatus_Escaped;
	cs = CollarStatus_CollarStatus_Normal;
	mode = Mode_Teach;
	zone = NO_ZONE;

	set_sensor_modes(mode, fs, cs, zone);
	zassert_equal(k_sem_take(&gnss_mode_sem, K_SECONDS(30)), 0, "");
	zassert_equal(current_gnss_mode, GNSSMODE_PSM, "");
}

static bool event_handler(const struct event_header *eh)
{
	if (is_gnss_set_mode_event(eh)) {
		struct gnss_set_mode_event *ev = cast_gnss_set_mode_event(eh);
		current_gnss_mode = ev->mode;
		k_sem_give(&gnss_mode_sem);
	}
	return false;
}

EVENT_LISTENER(test_gnss_handler, event_handler);
EVENT_SUBSCRIBE(test_gnss_handler, gnss_set_mode_event);
```

## src/amc_test_common.h
```c
/*
 * Copyright (c) 2022 Nofence AS
 */

#ifndef _AMC_TEST_COMMON_H_
#define _AMC_TEST_COMMON_H_

void test_fnc_calc_dist_quadratic(void);
void test_fnc_calc_dist_quadratic_max(void);
void test_fnc_calc_dist_rect(void);
void test_fnc_calc_dist_2_fences_hole(void);
void test_fnc_calc_dist_2_fences_hole2(void);
void test_fnc_calc_dist_2_fences_max_size(void);

void test_zone_calc(void);

void test_gnss_fix(void);
void test_gnss_mode(void);
void test_propagate_movement_out_event(void);

void test_collar_status(void);
void test_collar_mode(void);
void test_fence_status(void);

/* GNSS helper functions. */
void amc_gnss_init(void);
void simulate_no_fix(void);
void simulate_fix(void);
void simulate_easy_fix(void);
void simulate_accepted_fix(void);
void simulate_warn_fix(void);

void test_correction_gnss(void);
void test_correction_mode(void);
void test_correction_fence_status(void);
void test_correction_zone(void);
void test_correction_esacped(void);
void test_correction_active_delta(void);
void test_correction_dist_pause(void);
void test_correction_gnss_timeout(void);

#endif /* _AMC_TEST_COMMON_H_ */
```

## src/amc_zone_test.c
```c
#include "amc_test_common.h"
#include "amc_zone.h"
#include <ztest.h>

void test_zone_calc(void)
{
	zone_set(NO_ZONE);

	gnss_t gnss_data = {
		.latest = { .pvt_flags = 1, .msss = 25000, .updated_at = k_uptime_get_32() },
		.fix_ok = true,
		.lastfix = { .pvt_flags = 1 },
		.has_lastfix = true
	};

	amc_zone_t cur_zone = NO_ZONE;

	zassert_equal(zone_get(), NO_ZONE, "Zone not initialized correctly");

	/* Check updated since timer */
	zassert_true(zone_get_time_since_update() < 5, "Time since update is wrong");

	k_sleep(K_MSEC(100));

	zassert_true((zone_get_time_since_update() > 100) && (zone_get_time_since_update() < 150),
		     "Time since update is wrong");

	/* Position on border */
	zassert_equal(zone_update(0, &gnss_data, &cur_zone), 0, "Failed to update zone");
	zassert_equal(cur_zone, WARN_ZONE, "Position on border, but not in warn zone");

	/* Check updated since timer reset */
	zassert_true(zone_get_time_since_update() < 5, "Time since update is wrong");

	/* Get position after change */
	zassert_equal(zone_get(), WARN_ZONE, "Zone not updated correctly");

	/* Check updated since timer */
	k_sleep(K_MSEC(500));
	zassert_true((zone_get_time_since_update() > 500) && (zone_get_time_since_update() < 550),
		     "Time since update is wrong");

	printk("Since updated: %d", (uint32_t)zone_get_time_since_update());
	/* Even further outside border */
	for (int i = 0; i < 10; i++) {
		zassert_equal(zone_update(i, &gnss_data, &cur_zone), 0, "Failed to update zone");

		zassert_equal(cur_zone, WARN_ZONE, "Not in warn zone as expected");

		k_sleep(K_MSEC(100));
		printk("Since updated: %d", (uint32_t)zone_get_time_since_update());
	}
	/* No change, check timer, wide range since simulator is not good with time */
	printk("Since updated: %d", (uint32_t)zone_get_time_since_update());
	zassert_true((zone_get_time_since_update() > 1500) && (zone_get_time_since_update() < 1750),
		     "Time since update is wrong");

	/* Moving back to border */
	for (int i = 0; i < 10; i++) {
		zassert_equal(zone_update(10 - 1 - i, &gnss_data, &cur_zone), 0,
			      "Failed to update zone");

		zassert_equal(cur_zone, WARN_ZONE, "Not in warn zone as expected");
	}

	/* Going within border */
	zassert_equal(zone_update(-1, &gnss_data, &cur_zone), 0, "Failed to update zone");
	zassert_equal(cur_zone, PREWARN_ZONE, "Not in prewarn zone as expected");

	/* Going to prewarn/caution border, but not over hysteresis */
	zassert_equal(zone_update(-60, &gnss_data, &cur_zone), 0, "Failed to update zone");
	zassert_equal(cur_zone, PREWARN_ZONE, "Not in prewarn zone as expected");

	/* Going within caution, from above, must go one beyond to be outside [start, end> */
	zassert_equal(zone_update(-71, &gnss_data, &cur_zone), 0, "Failed to update zone");
	zassert_equal(cur_zone, CAUTION_ZONE, "Not in caution zone as expected");

	/* Going back to prewarn/caution border, but not over hysteresis */
	zassert_equal(zone_update(-60, &gnss_data, &cur_zone), 0, "Failed to update zone");
	zassert_equal(cur_zone, CAUTION_ZONE, "Not in caution zone as expected");

	/* Going to prewarn, from below, can be on hysteresis border and be within [start, end> */
	zassert_equal(zone_update(-50, &gnss_data, &cur_zone), 0, "Failed to update zone");
	zassert_equal(cur_zone, PREWARN_ZONE, "Not in prewarn zone as expected");

	/* Going well within warn zone */
	zassert_equal(zone_update(250, &gnss_data, &cur_zone), 0, "Failed to update zone");
	zassert_equal(cur_zone, WARN_ZONE, "Not in warn zone as expected");

	/* Going well within psm zone */
	zassert_equal(zone_update(-250, &gnss_data, &cur_zone), 0, "Failed to update zone");
	zassert_equal(cur_zone, PSM_ZONE, "Not in psm zone as expected");

	/* Failing position */
	zassert_equal(zone_set(NO_ZONE), 0, "Unable to set NO_ZONE");
	zassert_equal(zone_get(), NO_ZONE, "Not in no zone as expected");

	/* Extremes minimum */
	zassert_equal(zone_update(INT16_MIN, &gnss_data, &cur_zone), 0, "Failed to update zone");
	zassert_equal(cur_zone, PSM_ZONE, "Not in psm zone as expected");

	/* Extremes maximum, but should fail due to low time since PSM start */
	zassert_equal(zone_update(INT16_MAX, &gnss_data, &cur_zone), -ETIME,
		      "Not enough time since PSM");

	/* Extremes maximum, With wait since PSM */
	k_sleep(K_MSEC(16000));
	zassert_equal(zone_update(INT16_MAX, &gnss_data, &cur_zone), 0, "Failed to update zone");

	zassert_equal(cur_zone, WARN_ZONE, "Not in warn zone as expected");

	/* Set erroneous zone */
	zassert_equal(zone_set(94), -EINVAL, "Wrong result code when setting invalid zone");
}
```

## src/messaging_test.c
```c
/*
 * Copyright (c) 2022 Nofence AS
 */

#include <ztest.h>
#include "messaging.h"
#include "ble_ctrl_event.h"
#include "ble_data_event.h"
#include "lte_proto_event.h"

enum test_event_id { TEST_EVENT_CONTENTS = 0, TEST_EVENT_THREAD_POLLER = 1 };
static enum test_event_id cur_id = TEST_EVENT_CONTENTS;

/* Provide custom assert post action handler to handle the assertion on OOM
 * error in Event Manager.
 */
BUILD_ASSERT(!IS_ENABLED(CONFIG_ASSERT_NO_FILE_INFO));
void assert_post_action(const char *file, unsigned int line)
{
	printk("assert_post_action - file: %s (line: %u)\n", file, line);
}

void test_init(void)
{
	zassert_false(event_manager_init(),
		      "Error when initializing event manager");
}

/* Store dummy data. */
static uint8_t dummy_data[4] = { 0xDE, 0xAD, 0xBE, 0xEF };
struct ble_ctrl_event dummy_ctrl_event = { .param.battery = 5 };

void test_event_contents(void)
{
	/* Allocate events. */
	struct ble_ctrl_event *ev_ble_ctrl = new_ble_ctrl_event();
	struct ble_data_event *ev_ble_data = new_ble_data_event();
	struct lte_proto_event *ev_lte_proto = new_lte_proto_event();

	/* BLE CTRL event. */
	ev_ble_ctrl->cmd = BLE_CTRL_BATTERY_UPDATE;
	ev_ble_ctrl->param.battery = dummy_ctrl_event.param.battery;

	/* BLE data event. */
	ev_ble_data->buf = dummy_data;
	ev_ble_data->len = sizeof(dummy_data);

	/* LTE data event. */
	ev_lte_proto->buf = dummy_data;
	ev_lte_proto->len = sizeof(dummy_data);

	/* Submit events. */
	EVENT_SUBMIT(ev_ble_ctrl);
	EVENT_SUBMIT(ev_ble_data);
	EVENT_SUBMIT(ev_lte_proto);
}

void test_event_poller(void)
{
	/* Allocate events. */
	struct ble_ctrl_event *ev_ble_ctrl = new_ble_ctrl_event();
	struct ble_data_event *ev_ble_data = new_ble_data_event();
	struct lte_proto_event *ev_lte_proto = new_lte_proto_event();

	/* Submit events. */
	EVENT_SUBMIT(ev_ble_ctrl);
	EVENT_SUBMIT(ev_ble_data);
	EVENT_SUBMIT(ev_lte_proto);

	/* Wait for semaphores. */
	int err = k_sem_take(&ble_ctrl_sem, K_SECONDS(30));
	zassert_equal(err, 0, "ble_ctrl_sem hanged.");

	err = k_sem_take(&ble_data_sem, K_SECONDS(30));
	zassert_equal(err, 0, "ble_data_sem hanged.");

	err = k_sem_take(&lte_proto_sem, K_SECONDS(30));
	zassert_equal(err, 0, "lte_proto_sem hanged.");
}

void test_main(void)
{
	ztest_test_suite(messaging_tests, ztest_unit_test(test_init),
			 ztest_unit_test(test_event_contents),
			 ztest_unit_test(test_event_poller));
	ztest_run_test_suite(messaging_tests);
}

static bool event_handler(const struct event_header *eh)
{
	if (cur_id == TEST_EVENT_CONTENTS) {
		if (is_ble_ctrl_event(eh)) {
			struct ble_ctrl_event *ev = cast_ble_ctrl_event(eh);
			switch (ev->cmd) {
			case BLE_CTRL_BATTERY_UPDATE:
				zassert_equal(ev->param.battery,
					      dummy_ctrl_event.param.battery,
					      "Battery update mismatch.");
				break;
			default:
				zassert_unreachable(
					"Unexpected command event.");
			}
		}
		if (is_ble_data_event(eh)) {
			struct ble_data_event *ev = cast_ble_data_event(eh);
			zassert_equal(ev->len, sizeof(dummy_data),
				      "Buffer length mismatch");
			zassert_mem_equal(ev->buf, dummy_data, ev->len,
					  "Contents not equal.");
		}
		if (is_lte_proto_event(eh)) {
			struct lte_proto_event *ev = cast_lte_proto_event(eh);
			zassert_equal(ev->len, sizeof(dummy_data),
				      "Buffer length mismatch");
			zassert_mem_equal(ev->buf, dummy_data, ev->len,
					  "Contents not equal.");
			cur_id = TEST_EVENT_THREAD_POLLER;
		}
	}
	return false;
}

EVENT_LISTENER(test_main, event_handler);
EVENT_SUBSCRIBE(test_main, ble_ctrl_event);
EVENT_SUBSCRIBE(test_main, ble_data_event);
EVENT_SUBSCRIBE(test_main, lte_proto_event);
```
