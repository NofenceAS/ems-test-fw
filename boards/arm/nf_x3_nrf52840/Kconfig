## boards/arm/nf_x3_nrf52840/Kconfig
```kconfig
# nRF52840 DK NRF52840 board configuration

# Copyright (c) 2016 Nordic Semiconductor ASA
# SPDX-License-Identifier: Apache-2.0

config BOARD_ENABLE_DCDC
	bool "Enable DCDC mode"
	select SOC_DCDC_NRF52X
	default y
	depends on BOARD_NF_X3_NRF52840
	
config BOARD_VDD_PWR_CTRL_INIT_PRIORITY
	int "VDD power rail init priority"
	default 50
	depends on GPIO
	help
	  Initialization priority for the VDD power rail. Has to be greater
	  than GPIO_NRF_INIT_PRIORITY.
```

## modules/zoem8b_gps/dts/bindings/ublox,zoem8bspi.yaml
```yaml
# A YAML binding matching the node
description: |
  Ublox M8 receiver accessed through SPI bus

compatible: "ublox,zoem8bspi"

include: [ "spi-device.yaml" ]

properties:
  reg:
    required: true

  reset-gpios:
    type: phandle-array
    required: false
    description: RESETn pin
```

## modules/zoem8b_gps/zephyr/Kconfig
```kconfig
menuconfig ZOEM8B_GPS
	bool "Zoe M8B SPI driver"
	depends on SPI
	# FPU_SHARING needs to be enabled if FPU is enabled, as other contexts
	# might also use the FPU.
	select FPU_SHARING if FPU
	help
	  Enable Ublox Zoe M8B driver

if ZOEM8B_GPS

config ZOEM8B_GPS_DEV_NAME
	string "ZOE M8B GPS device name"
	default "ZOEM8B_GPS"

config ZOEM8B_GPS_INIT_PRIO
    	int "Initialization priority"
    	default 90

config ZOEM8B_GPS_THREAD_STACK_SIZE
	int "Thread stack size"
	default 2048

config ZOEM8B_GPS_THREAD_PRIORITY
    	int "Thread (preemtible) priority"
    	default 10

endif
```

## src/drivers/gnss/zephyr/Kconfig
```kconfig
menuconfig GNSS
	bool "GNSS Drivers"
	select RING_BUFFER
	help
	  Enable config options for GNSS drivers.

if GNSS
	config GNSS_LOG_LEVEL
		int "Log level for the GNSS driver"
		default 4
		
	config GNSS_INIT_PRIORITY
		int "GNSS init priority"
		default 90
		help
		GNSS initialization priority.
		
	config GNSS_NMEA_PARSER
		bool "Enable NMEA parser for GNSS data"
		default n

	config GNSS_COMM_BUFFER_SIZE
		int "Memory to allocate for RX/TX buffers."
		default 1024

	rsource "Kconfig.ublox-mia-m10"

endif # GNSS
```

## src/drivers/gnss/zephyr/Kconfig.ublox-mia-m10
```kconfig
config GNSS_UBLOX_MIA_M10
	bool "Enable u-blox MIA-M10 GNSS driver"
	help
	  Choose this setting to enable u-blox MIA-M10 GNSS driver.

if GNSS_UBLOX_MIA_M10

	config GNSS_MIA_M10_UART_BAUDRATE
		int "Baudrate to use for communication. Will be initiated during setup."
		default 115200

# See https://content.u-blox.com/sites/default/files/u-blox-M10-SPG-5.10_InterfaceDescription_UBX-21035062.pdf?hash=undefined
# For UBX-ACK-ACK, the comment read:
# Output upon processing of an input message. A UBX-ACK-ACK is sent as soon as possible but at least within one second

	config GNSS_MIA_M10_CMD_RESP_TIMEOUT
		int "Duration in milliseconds to wait for response after command. One second according to u-blox manual"
		default 1000

	config GNSS_MIA_M10_CMD_MAX_SIZE
		int "Memory to allocate for command/response buffer."
		default 256

	config GNSS_MIA_M10_PARSE_STACK_SIZE
		int "Stack size for the u-blox MIA-M10 GNSS driver RX thread"
		default 1024
		help
		This stack is used by the u-blox MIA-M10 RX thread.
	
	config GNSS_MIA_M10_THREAD_PRIORITY
		int "Priority of the parsing thread. Run as cooperative thread."
		default 7
		help
		This priority is used by the u-blox MIA-M10 RX thread.

endif # GNSS_UBLOX_MIA_M10
```

## src/events/Kconfig
```kconfig
#
# Copyright (c) 2020 Nordic Semiconductor
#
# SPDX-License-Identifier: LicenseRef-Nordic-5-Clause
#

menuconfig EVENTS
	bool "Event options"
	default y

if EVENTS

config STORAGE_EVENTS_LOG
	bool "Enable logging for GPS module events"
	default y

config CONFIG_EVENTS_LOG
	bool "Enable logging for GPS module events"
	default y

endif #EVENTS
```

## src/events/ble/Kconfig
```kconfig
# Copyright (c) 2021 Nofence AS
 
if LOG

menu "Event options"

comment "Initially logged events"

config LOG_BLE_DATA_EVENT
	bool "BLE data event"
	default n

config LOG_BLE_CTRL_EVENT
	bool "BLE control event"
	default n

config LOG_BLE_CONN_EVENT
	bool "BLE connection event"
	default n

config LOG_BLE_BEACON_EVENT
	bool "BLE connection event"
	default n

endmenu

endif
```

## src/events/buzzer/Kconfig
```kconfig
# Copyright (c) 2021 Nofence AS
 
if LOG

menu "Event options"
comment "Initially logged events"

config LOG_SOUND_EVENT
	bool "Sound status event"
	default y
	
endmenu

endif
```

## src/events/diagnostics/Kconfig
```kconfig
# Copyright (c) 2021 Nofence AS
 
if LOG

menu "Event options"
comment "Initially logged events"

config LOG_DIAGNOSTICS_EVENT
	bool "Diagnostics status event"
	default y
	
endmenu

endif
```

## src/events/electric_pulse/Kconfig
```kconfig
# Copyright (c) 2021 Nofence AS
 
if LOG

menu "Event options"

comment "Initially logged events"

config LOG_EP_EVENT
	bool "BLE data event"
	default y
endif
```

## src/events/environment/Kconfig
```kconfig
# Copyright (c) 2021 Nofence AS
 
if LOG

menu "Event options"
comment "Initially logged events"

config LOG_ENVIRONMENT_EVENT
	bool "Environment status event"
	default y

config LOG_REQUEST_ENVIRONMENT_EVENT
	bool "Request environment status event"
	default n
	
endmenu

endif
```

## src/events/error_handler/Kconfig
```kconfig
# Copyright (c) 2021 Nofence AS
 
if LOG

menu "Event options"
comment "Initially logged events"

config LOG_ERROR_EVENT
	bool "Error status event"
	default y
	
endmenu

endif
```

## src/events/fw_upgrade/Kconfig
```kconfig
# Copyright (c) 2022 Nofence AS
 
menu "Event options"
config FW_UPGRADE_PATH_LEN
	int "Max length of firmware upgrade host name (ip address/port)"
	default 64

config FW_UPGRADE_HOST_LEN
	int "Max length of firmware upgrade path name"
	default 64

config FW_LOG_DFU_STATUS_EVENT
	bool "Log DFU FW event"
	default n
endmenu
```

## src/events/lte/Kconfig
```kconfig
#
# Copyright (c) 2022 Nofence
#

if LOG

menu "Event options"

comment "Initially logged events"

config LOG_LTE_DATA_EVENT
	bool "BLE data event"
	default y

endmenu

endif
```

## src/events/messaging/Kconfig
```kconfig
# Copyright (c) 2021 Nofence AS
 
if LOG

menu "Event options"

comment "Initially logged events"

config LOG_MODULE_STATE_EVENT
	bool "Module state event"
	default y

config LOG_MSG_DATA_EVENT
	bool "MSG data event"
	default y

endmenu

endif
```

## src/events/movement_controller/Kconfig
```kconfig
# Copyright (c) 2021 Nofence AS
 
if LOG

menu "Event options"
comment "Initially logged events"

config LOG_MOVEMENT_EVENT
	bool "Movement status event"
	default y

endmenu

endif
```

## src/events/msg/Kconfig
```kconfig
# Copyright (c) 2021 Nofence AS
 
if LOG

menu "Event options"

comment "Initially logged events"

config LOG_MODULE_STATE_EVENT
	bool "Module state event"
	default y

config LOG_MSG_DATA_EVENT
	bool "MSG data event"
	default y

config LOG_PEER_CONN_EVENT
	bool "Peer connection event"
	default y

endmenu

endif
```

## src/events/power_manager/Kconfig
```kconfig
# Copyright (c) 2021 Nofence AS
 
if LOG

menu "Event options"

comment "Initially logged events"

config LOG_PWR_EVENT
	bool "PWR state status event"
	default y

endmenu

endif
```

## src/events/storage_controller/Kconfig
```kconfig
# Copyright (c) 2022 Nofence AS
 
if LOG
menu "Event options"
config STORAGE_EVENTS_LOG
	bool "Logging of the storage controller events"
	default y

endmenu
endif
```

## tests/amc/testcase.yaml
```yaml
tests:
  animal_monitor_control.test:
    platform_allow: native_posix
    tags: event_manager
```

## tests/collar_protocol/testcase.yaml
```yaml
tests:
  collar_protocol.test:
    platform_allow: native_posix
    tags: protocol protobuf
```

## tests/drivers/gnss/mock/zephyr/Kconfig
```kconfig
config SERIAL_MOCK
	bool "Force support for interrupt driven UART"
	select SERIAL
	select SERIAL_SUPPORT_INTERRUPT
	select UART_INTERRUPT_DRIVEN
	default y
```
